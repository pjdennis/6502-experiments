; These note values represent a half period of the wave
; note-half-period = CLOCK_FREQ_KHZ * 1000.0 Hz / note-freq-hz / 2

NOTE_C3  = CLOCK_FREQ_KHZ * 50000 /  13081 ;  130.81 Hz
NOTE_CS3 = CLOCK_FREQ_KHZ * 50000 /  13859 ;  138.59 Hz
NOTE_D3  = CLOCK_FREQ_KHZ * 50000 /  14683 ;  146.83 Hz
NOTE_DS3 = CLOCK_FREQ_KHZ * 50000 /  15556 ;  155.56 Hz
NOTE_E3  = CLOCK_FREQ_KHZ * 50000 /  16481 ;  164.81 Hz
NOTE_F3  = CLOCK_FREQ_KHZ * 50000 /  17461 ;  174.61 Hz
NOTE_FS3 = CLOCK_FREQ_KHZ * 50000 /  18500 ;  185.00 Hz
NOTE_G3  = CLOCK_FREQ_KHZ * 50000 /  19600 ;  196.00 Hz
NOTE_GS3 = CLOCK_FREQ_KHZ * 50000 /  20765 ;  207.65 Hz
NOTE_A3  = CLOCK_FREQ_KHZ * 50000 /  22000 ;  220.00 Hz
NOTE_AS3 = CLOCK_FREQ_KHZ * 50000 /  23308 ;  233.08 Hz
NOTE_B3  = CLOCK_FREQ_KHZ * 50000 /  24694 ;  246.94 Hz
NOTE_C4  = CLOCK_FREQ_KHZ * 50000 /  26163 ;  261.63 Hz
NOTE_CS4 = CLOCK_FREQ_KHZ * 50000 /  27718 ;  277.18 Hz
NOTE_D4  = CLOCK_FREQ_KHZ * 50000 /  29366 ;  293.66 Hz
NOTE_DS4 = CLOCK_FREQ_KHZ * 50000 /  31113 ;  311.13 Hz
NOTE_E4	 = CLOCK_FREQ_KHZ * 50000 /  32963 ;  329.63 Hz
NOTE_F4	 = CLOCK_FREQ_KHZ * 50000 /  34923 ;  349.23 Hz
NOTE_FS4 = CLOCK_FREQ_KHZ * 50000 /  36999 ;  369.99 Hz
NOTE_G4	 = CLOCK_FREQ_KHZ * 50000 /  39200 ;  392.00 Hz
NOTE_GS4 = CLOCK_FREQ_KHZ * 50000 /  41530 ;  415.30 Hz
NOTE_A4  = CLOCK_FREQ_KHZ * 50000 /  44000 ;  440.00 Hz
NOTE_AS4 = CLOCK_FREQ_KHZ * 50000 /  46616 ;  466.16 Hz
NOTE_B4  = CLOCK_FREQ_KHZ * 50000 /  49388 ;  493.88 Hz
NOTE_C5  = CLOCK_FREQ_KHZ * 50000 /  52325 ;  523.25 Hz
NOTE_CS5 = CLOCK_FREQ_KHZ * 50000 /  55437 ;  554.37 Hz
NOTE_D5  = CLOCK_FREQ_KHZ * 50000 /  58733 ;  587.33 Hz
NOTE_DS5 = CLOCK_FREQ_KHZ * 50000 /  62225 ;  622.25 Hz
NOTE_E5	 = CLOCK_FREQ_KHZ * 50000 /  65925 ;  659.25 Hz
NOTE_F5	 = CLOCK_FREQ_KHZ * 50000 /  69846 ;  698.46 Hz
NOTE_FS5 = CLOCK_FREQ_KHZ * 50000 /  73999 ;  739.99 Hz
NOTE_G5	 = CLOCK_FREQ_KHZ * 50000 /  78399 ;  783.99 Hz
NOTE_GS5 = CLOCK_FREQ_KHZ * 50000 /  83061 ;  830.61 Hz
NOTE_A5  = CLOCK_FREQ_KHZ * 50000 /  88000 ;  880.00 Hz
NOTE_AS5 = CLOCK_FREQ_KHZ * 50000 /  93233 ;  932.33 Hz
NOTE_B5  = CLOCK_FREQ_KHZ * 50000 /  98777 ;  987.77 Hz
NOTE_C6  = CLOCK_FREQ_KHZ * 50000 / 104650 ; 1046.50 Hz

NOTE_DF3 = NOTE_CS3
NOTE_EF3 = NOTE_DS3
NOTE_GF3 = NOTE_FS3
NOTE_AF3 = NOTE_GS3
NOTE_BF3 = NOTE_AS3
NOTE_DF4 = NOTE_CS4
NOTE_EF4 = NOTE_DS4
NOTE_GF4 = NOTE_FS4
NOTE_AF4 = NOTE_GS4
NOTE_BF4 = NOTE_AS4
NOTE_DF5 = NOTE_CS5
NOTE_EF5 = NOTE_DS5
NOTE_GF5 = NOTE_FS5
NOTE_AF5 = NOTE_GS5
NOTE_BF5 = NOTE_AS5

NOTE_IDX_C3  =  0
NOTE_IDX_CS3 =  1
NOTE_IDX_D3  =  2
NOTE_IDX_DS3 =  3
NOTE_IDX_E3  =  4
NOTE_IDX_F3  =  5
NOTE_IDX_FS3 =  6
NOTE_IDX_G3  =  7
NOTE_IDX_GS3 =  8
NOTE_IDX_A3  =  9
NOTE_IDX_AS3 = 10
NOTE_IDX_B3  = 11
NOTE_IDX_C4  = 12
NOTE_IDX_CS4 = 13
NOTE_IDX_D4  = 14
NOTE_IDX_DS4 = 15
NOTE_IDX_E4  = 16
NOTE_IDX_F4  = 17
NOTE_IDX_FS4 = 18
NOTE_IDX_G4  = 19
NOTE_IDX_GS4 = 20
NOTE_IDX_A4  = 21
NOTE_IDX_AS4 = 22
NOTE_IDX_B4  = 23
NOTE_IDX_C5  = 24
NOTE_IDX_CS5 = 25
NOTE_IDX_D5  = 26
NOTE_IDX_DS5 = 27
NOTE_IDX_E5  = 28
NOTE_IDX_F5  = 29
NOTE_IDX_FS5 = 30
NOTE_IDX_G5  = 31
NOTE_IDX_GS5 = 32
NOTE_IDX_A5  = 33
NOTE_IDX_AS5 = 34
NOTE_IDX_B5  = 35
NOTE_IDX_C6  = 36

NOTE_IDX_REST = 254
NOTE_IDX_NULL = 255

NOTE_IDX_DF3 = NOTE_IDX_CS3
NOTE_IDX_EF3 = NOTE_IDX_DS3
NOTE_IDX_GF3 = NOTE_IDX_FS3
NOTE_IDX_AF3 = NOTE_IDX_GS3
NOTE_IDX_BF3 = NOTE_IDX_AS3
NOTE_IDX_DF4 = NOTE_IDX_CS4
NOTE_IDX_EF4 = NOTE_IDX_DS4
NOTE_IDX_GF4 = NOTE_IDX_FS4
NOTE_IDX_AF4 = NOTE_IDX_GS4
NOTE_IDX_BF4 = NOTE_IDX_AS4
NOTE_IDX_DF5 = NOTE_IDX_CS5
NOTE_IDX_EF5 = NOTE_IDX_DS5
NOTE_IDX_GF5 = NOTE_IDX_FS5
NOTE_IDX_AF5 = NOTE_IDX_GS5
NOTE_IDX_BF5 = NOTE_IDX_AS5


DURATION_SEMIQUAVER = 15000 / MUSIC_BPM
DURATION_QUAVER                            = DURATION_SEMIQUAVER *  2
DURATION_DOTTED_QUAVER                     = DURATION_SEMIQUAVER *  3
DURATION_CROTCHET                          = DURATION_SEMIQUAVER *  4
DURATION_CROTCHET_TIE_QUAVER               = DURATION_SEMIQUAVER *  5
DURATION_DOTTED_CROTCHET                   = DURATION_SEMIQUAVER *  6
DURATION_DOUBLE_DOTTED_CROTCHET            = DURATION_SEMIQUAVER *  7
DURATION_MINIM                             = DURATION_SEMIQUAVER *  8
DURATION_MINIM_TIE_SEMIQUAVER              = DURATION_SEMIQUAVER *  9
DURATION_MINIM_TIE_QUAVER                  = DURATION_SEMIQUAVER * 10
DURATION_MINIM_TIE_DOTTED_QUAVER           = DURATION_SEMIQUAVER * 11
DURATION_DOTTED_MINIM                      = DURATION_SEMIQUAVER * 12
DURATION_MINIM_TIE_CROTCHET_TIE_SEMIQUAVER = DURATION_SEMIQUAVER * 13
DURATION_DOUBLE_DOTTED_MINIM               = DURATION_SEMIQUAVER * 14
DURATION_TRIPLE_DOTTED_MINIM               = DURATION_SEMIQUAVER * 15
DURATION_SEMIBREVE                         = DURATION_SEMIQUAVER * 16
DURATION_INTER_NOTE                        = DURATION_SEMIQUAVER /  2

DURATION_IDX_SEMIQUAVER                        =  0
DURATION_IDX_QUAVER                            =  1
DURATION_IDX_DOTTED_QUAVER                     =  2
DURATION_IDX_CROTCHET                          =  3
DURATION_IDX_CROTCHET_TIE_QUAVER               =  4
DURATION_IDX_DOTTED_CROTCHET                   =  5
DURATION_IDX_DOUBLE_DOTTED_CROTCHET            =  6
DURATION_IDX_MINIM                             =  7
DURATION_IDX_MINIM_TIE_SEMIQUAVER              =  8
DURATION_IDX_MINIM_TIE_QUAVER                  =  9
DURATION_IDX_MINIM_TIE_DOTTED_QUAVER           = 10
DURATION_IDX_DOTTED_MINIM                      = 11
DURATION_IDX_MINIM_TIE_CROTCHET_TIE_SEMIQUAVER = 12
DURATION_IDX_DOUBLE_DOTTED_MINIM               = 13
DURATION_IDX_TRIPLE_DOTTED_MINIM               = 14
DURATION_IDX_SEMIBREVE                         = 15
