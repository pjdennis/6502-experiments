play_star_spangled_banner:
  lda #<star_spangled_banner
  ldx #>star_spangled_banner
  jmp play_song ; tail call

star_spangled_banner:
  .byte NOTE_IDX_F4,   DURATION_IDX_QUAVER
  .byte NOTE_IDX_D4,   DURATION_IDX_QUAVER

  .byte NOTE_IDX_BF3,  DURATION_IDX_CROTCHET
  .byte NOTE_IDX_D4,   DURATION_IDX_CROTCHET
  .byte NOTE_IDX_F4,   DURATION_IDX_CROTCHET

  .byte NOTE_IDX_BF4,  DURATION_IDX_MINIM
  .byte NOTE_IDX_D5,   DURATION_IDX_QUAVER
  .byte NOTE_IDX_C5,   DURATION_IDX_QUAVER

  .byte NOTE_IDX_BF4,  DURATION_IDX_CROTCHET
  .byte NOTE_IDX_D4,   DURATION_IDX_CROTCHET
  .byte NOTE_IDX_E4,   DURATION_IDX_CROTCHET
  
  .byte NOTE_IDX_F4,   DURATION_IDX_CROTCHET
  .byte NOTE_IDX_F4,   DURATION_IDX_QUAVER
  .byte NOTE_IDX_F4,   DURATION_IDX_SEMIQUAVER
  .byte NOTE_IDX_REST, DURATION_IDX_SEMIQUAVER
  .byte NOTE_IDX_F4,   DURATION_IDX_SEMIQUAVER
  .byte NOTE_IDX_REST, DURATION_IDX_SEMIQUAVER
  .byte NOTE_IDX_F4,   DURATION_IDX_QUAVER

  .byte NOTE_IDX_D5,   DURATION_IDX_CROTCHET
  .byte NOTE_IDX_C5,   DURATION_IDX_CROTCHET
  .byte NOTE_IDX_BF4,  DURATION_IDX_CROTCHET

  .byte NOTE_IDX_A4,   DURATION_IDX_MINIM
  .byte NOTE_IDX_G4,   DURATION_IDX_QUAVER
  .byte NOTE_IDX_A4,   DURATION_IDX_QUAVER

  .byte NOTE_IDX_BF4,  DURATION_IDX_QUAVER
  .byte NOTE_IDX_BF4,  DURATION_IDX_SEMIQUAVER
  .byte NOTE_IDX_REST, DURATION_IDX_SEMIQUAVER
  .byte NOTE_IDX_BF4,  DURATION_IDX_CROTCHET
  .byte NOTE_IDX_F4,   DURATION_IDX_CROTCHET

  .byte NOTE_IDX_D4,   DURATION_IDX_CROTCHET
  .byte NOTE_IDX_BF3,  DURATION_IDX_CROTCHET
  .byte NOTE_IDX_F4,   DURATION_IDX_QUAVER
  .byte NOTE_IDX_D4,   DURATION_IDX_QUAVER

  .byte NOTE_IDX_BF3,  DURATION_IDX_CROTCHET
  .byte NOTE_IDX_D4,   DURATION_IDX_CROTCHET
  .byte NOTE_IDX_F4,   DURATION_IDX_CROTCHET

  .byte NOTE_IDX_BF4,  DURATION_IDX_MINIM
  .byte NOTE_IDX_D5,   DURATION_IDX_QUAVER
  .byte NOTE_IDX_C5,   DURATION_IDX_QUAVER

  .byte NOTE_IDX_BF4,  DURATION_IDX_CROTCHET
  .byte NOTE_IDX_D4,   DURATION_IDX_CROTCHET
  .byte NOTE_IDX_E4,   DURATION_IDX_CROTCHET
  
  .byte NOTE_IDX_F4,   DURATION_IDX_CROTCHET
  .byte NOTE_IDX_F4,   DURATION_IDX_QUAVER
  .byte NOTE_IDX_F4,   DURATION_IDX_SEMIQUAVER
  .byte NOTE_IDX_REST, DURATION_IDX_SEMIQUAVER
  .byte NOTE_IDX_F4,   DURATION_IDX_SEMIQUAVER
  .byte NOTE_IDX_REST, DURATION_IDX_SEMIQUAVER
  .byte NOTE_IDX_F4,   DURATION_IDX_QUAVER

  .byte NOTE_IDX_D5,   DURATION_IDX_CROTCHET
  .byte NOTE_IDX_C5,   DURATION_IDX_CROTCHET
  .byte NOTE_IDX_BF4,  DURATION_IDX_CROTCHET

  .byte NOTE_IDX_A4,   DURATION_IDX_MINIM
  .byte NOTE_IDX_G4,   DURATION_IDX_QUAVER
  .byte NOTE_IDX_A4,   DURATION_IDX_QUAVER

  .byte NOTE_IDX_BF4,  DURATION_IDX_QUAVER
  .byte NOTE_IDX_BF4,  DURATION_IDX_SEMIQUAVER
  .byte NOTE_IDX_REST, DURATION_IDX_SEMIQUAVER
  .byte NOTE_IDX_BF4,  DURATION_IDX_CROTCHET
  .byte NOTE_IDX_F4,   DURATION_IDX_CROTCHET

  .byte NOTE_IDX_D4,   DURATION_IDX_CROTCHET
  .byte NOTE_IDX_BF3,  DURATION_IDX_CROTCHET
  .byte NOTE_IDX_D5,   DURATION_IDX_SEMIQUAVER
  .byte NOTE_IDX_REST, DURATION_IDX_SEMIQUAVER
  .byte NOTE_IDX_D5,   DURATION_IDX_SEMIQUAVER
  .byte NOTE_IDX_REST, DURATION_IDX_SEMIQUAVER

  .byte NOTE_IDX_D5,   DURATION_IDX_CROTCHET
  .byte NOTE_IDX_EF5,  DURATION_IDX_CROTCHET
  .byte NOTE_IDX_F5,   DURATION_IDX_QUAVER
  .byte NOTE_IDX_F5,   DURATION_IDX_SEMIQUAVER
  .byte NOTE_IDX_REST, DURATION_IDX_SEMIQUAVER

  .byte NOTE_IDX_F5,   DURATION_IDX_MINIM
  .byte NOTE_IDX_EF5,  DURATION_IDX_QUAVER
  .byte NOTE_IDX_D5,   DURATION_IDX_QUAVER

  .byte NOTE_IDX_C5,   DURATION_IDX_CROTCHET
  .byte NOTE_IDX_D5,   DURATION_IDX_CROTCHET
  .byte NOTE_IDX_EF5,  DURATION_IDX_QUAVER
  .byte NOTE_IDX_EF5,  DURATION_IDX_SEMIQUAVER
  .byte NOTE_IDX_REST, DURATION_IDX_SEMIQUAVER

  .byte NOTE_IDX_EF5,  DURATION_IDX_CROTCHET
  .byte NOTE_IDX_EF5,  DURATION_IDX_QUAVER
  .byte NOTE_IDX_EF5,  DURATION_IDX_SEMIQUAVER
  .byte NOTE_IDX_REST, DURATION_IDX_SEMIQUAVER
  .byte NOTE_IDX_EF5,  DURATION_IDX_CROTCHET

  .byte NOTE_IDX_D5,   DURATION_IDX_CROTCHET
  .byte NOTE_IDX_C5,   DURATION_IDX_CROTCHET
  .byte NOTE_IDX_BF4,  DURATION_IDX_CROTCHET

  .byte NOTE_IDX_A4,   DURATION_IDX_MINIM
  .byte NOTE_IDX_G4,   DURATION_IDX_QUAVER
  .byte NOTE_IDX_A4,   DURATION_IDX_QUAVER

  .byte NOTE_IDX_BF4,  DURATION_IDX_CROTCHET
  .byte NOTE_IDX_D4,   DURATION_IDX_CROTCHET
  .byte NOTE_IDX_E4,   DURATION_IDX_CROTCHET

  .byte NOTE_IDX_F4,   DURATION_IDX_CROTCHET
  .byte NOTE_IDX_F4,   DURATION_IDX_QUAVER
  .byte NOTE_IDX_F4,   DURATION_IDX_SEMIQUAVER
  .byte NOTE_IDX_REST, DURATION_IDX_SEMIQUAVER
  .byte NOTE_IDX_F4,   DURATION_IDX_CROTCHET

  .byte NOTE_IDX_BF4,  DURATION_IDX_QUAVER
  .byte NOTE_IDX_BF4,  DURATION_IDX_SEMIQUAVER
  .byte NOTE_IDX_REST, DURATION_IDX_SEMIQUAVER
  .byte NOTE_IDX_BF4,  DURATION_IDX_QUAVER
  .byte NOTE_IDX_BF4,  DURATION_IDX_SEMIQUAVER
  .byte NOTE_IDX_REST, DURATION_IDX_SEMIQUAVER
  .byte NOTE_IDX_BF4,  DURATION_IDX_QUAVER
  .byte NOTE_IDX_A4,   DURATION_IDX_QUAVER

  .byte NOTE_IDX_G4,   DURATION_IDX_QUAVER
  .byte NOTE_IDX_G4,   DURATION_IDX_SEMIQUAVER
  .byte NOTE_IDX_REST, DURATION_IDX_SEMIQUAVER
  .byte NOTE_IDX_G4,   DURATION_IDX_QUAVER
  .byte NOTE_IDX_G4,   DURATION_IDX_SEMIQUAVER
  .byte NOTE_IDX_REST, DURATION_IDX_SEMIQUAVER
  .byte NOTE_IDX_G4,   DURATION_IDX_CROTCHET

  .byte NOTE_IDX_C5,   DURATION_IDX_CROTCHET
  .byte NOTE_IDX_EF5,  DURATION_IDX_QUAVER
  .byte NOTE_IDX_D5,   DURATION_IDX_QUAVER
  .byte NOTE_IDX_C5,   DURATION_IDX_QUAVER
  .byte NOTE_IDX_BF4,  DURATION_IDX_SEMIQUAVER
  .byte NOTE_IDX_REST, DURATION_IDX_SEMIQUAVER

  .byte NOTE_IDX_BF4,  DURATION_IDX_CROTCHET
  .byte NOTE_IDX_A4,   DURATION_IDX_MINIM      ; pause
  .byte NOTE_IDX_F4,   DURATION_IDX_SEMIQUAVER
  .byte NOTE_IDX_REST, DURATION_IDX_SEMIQUAVER
  .byte NOTE_IDX_F4,   DURATION_IDX_QUAVER

  .byte NOTE_IDX_BF4,  DURATION_IDX_CROTCHET
  .byte NOTE_IDX_BF4,  DURATION_IDX_QUAVER
  .byte NOTE_IDX_C5,   DURATION_IDX_QUAVER
  .byte NOTE_IDX_D5,   DURATION_IDX_QUAVER
  .byte NOTE_IDX_EF5,  DURATION_IDX_QUAVER

  .byte NOTE_IDX_F5,   DURATION_IDX_SEMIBREVE  ; pause
  .byte NOTE_IDX_BF4,  DURATION_IDX_QUAVER
  .byte NOTE_IDX_C5,   DURATION_IDX_QUAVER

  .byte NOTE_IDX_D5,   DURATION_IDX_CROTCHET
  .byte NOTE_IDX_D5,   DURATION_IDX_QUAVER
  .byte NOTE_IDX_EF5,  DURATION_IDX_QUAVER
  .byte NOTE_IDX_C5,   DURATION_IDX_CROTCHET

  .byte NOTE_IDX_BF4,  DURATION_IDX_MINIM

  .byte NOTE_IDX_NULL


