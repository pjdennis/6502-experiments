character_patterns:
  .byte $00, $00, $00, $00, $00, $00, $00, $00 ;  32 $20 ' '
  .byte $00, $00, $06, $5f, $5f, $06, $00, $00 ;  33 $21 '!'
  .byte $00, $03, $03, $00, $03, $03, $00, $00 ;  34 $22 '"'
  .byte $14, $7f, $7f, $14, $7f, $7f, $14, $00 ;  35 $23 '#'
  .byte $24, $2e, $6b, $6b, $3a, $12, $00, $00 ;  36 $24 '$'
  .byte $46, $66, $30, $18, $0c, $66, $62, $00 ;  37 $25 '%'
  .byte $30, $7a, $4f, $5d, $37, $7a, $48, $00 ;  38 $26 '&'
  .byte $04, $07, $03, $00, $00, $00, $00, $00 ;  39 $27 '''
  .byte $00, $1c, $3e, $63, $41, $00, $00, $00 ;  40 $28 '('
  .byte $00, $41, $63, $3e, $1c, $00, $00, $00 ;  41 $29 ')'
  .byte $08, $2a, $3e, $1c, $1c, $3e, $2a, $08 ;  42 $2a '*'
  .byte $08, $08, $3e, $3e, $08, $08, $00, $00 ;  43 $2b '+'
  .byte $00, $80, $e0, $60, $00, $00, $00, $00 ;  44 $2c ','
  .byte $08, $08, $08, $08, $08, $08, $00, $00 ;  45 $2d '-'
  .byte $00, $00, $60, $60, $00, $00, $00, $00 ;  46 $2e '.'
  .byte $60, $30, $18, $0c, $06, $03, $01, $00 ;  47 $2f '/'
  .byte $3e, $7f, $71, $59, $4d, $7f, $3e, $00 ;  48 $30 '0'
  .byte $40, $42, $7f, $7f, $40, $40, $00, $00 ;  49 $31 '1'
  .byte $62, $73, $59, $49, $6f, $66, $00, $00 ;  50 $32 '2'
  .byte $22, $63, $49, $49, $7f, $36, $00, $00 ;  51 $33 '3'
  .byte $18, $1c, $16, $53, $7f, $7f, $50, $00 ;  52 $34 '4'
  .byte $27, $67, $45, $45, $7d, $39, $00, $00 ;  53 $35 '5'
  .byte $3c, $7e, $4b, $49, $79, $30, $00, $00 ;  54 $36 '6'
  .byte $03, $03, $71, $79, $0f, $07, $00, $00 ;  55 $37 '7'
  .byte $36, $7f, $49, $49, $7f, $36, $00, $00 ;  56 $38 '8'
  .byte $06, $4f, $49, $69, $3f, $1e, $00, $00 ;  57 $39 '9'
  .byte $00, $00, $66, $66, $00, $00, $00, $00 ;  58 $3a ':'
  .byte $00, $80, $e6, $66, $00, $00, $00, $00 ;  59 $3b ';'
  .byte $08, $1c, $36, $63, $41, $00, $00, $00 ;  60 $3c '<'
  .byte $24, $24, $24, $24, $24, $24, $00, $00 ;  61 $3d '='
  .byte $00, $41, $63, $36, $1c, $08, $00, $00 ;  62 $3e '>'
  .byte $02, $03, $51, $59, $0f, $06, $00, $00 ;  63 $3f '?'
  .byte $3e, $7f, $41, $5d, $5d, $1f, $1e, $00 ;  64 $40 '@'
  .byte $7c, $7e, $13, $13, $7e, $7c, $00, $00 ;  65 $41 'A'
  .byte $41, $7f, $7f, $49, $49, $7f, $36, $00 ;  66 $42 'B'
  .byte $1c, $3e, $63, $41, $41, $63, $22, $00 ;  67 $43 'C'
  .byte $41, $7f, $7f, $41, $63, $3e, $1c, $00 ;  68 $44 'D'
  .byte $41, $7f, $7f, $49, $5d, $41, $63, $00 ;  69 $45 'E'
  .byte $41, $7f, $7f, $49, $1d, $01, $03, $00 ;  70 $46 'F'
  .byte $1c, $3e, $63, $41, $51, $73, $72, $00 ;  71 $47 'G'
  .byte $7f, $7f, $08, $08, $7f, $7f, $00, $00 ;  72 $48 'H'
  .byte $00, $41, $7f, $7f, $41, $00, $00, $00 ;  73 $49 'I'
  .byte $30, $70, $40, $41, $7f, $3f, $01, $00 ;  74 $4a 'J'
  .byte $41, $7f, $7f, $08, $1c, $77, $63, $00 ;  75 $4b 'K'
  .byte $41, $7f, $7f, $41, $40, $60, $70, $00 ;  76 $4c 'L'
  .byte $7f, $7f, $0e, $1c, $0e, $7f, $7f, $00 ;  77 $4d 'M'
  .byte $7f, $7f, $06, $0c, $18, $7f, $7f, $00 ;  78 $4e 'N'
  .byte $1c, $3e, $63, $41, $63, $3e, $1c, $00 ;  79 $4f 'O'
  .byte $41, $7f, $7f, $49, $09, $0f, $06, $00 ;  80 $50 'P'
  .byte $1e, $3f, $21, $71, $7f, $5e, $00, $00 ;  81 $51 'Q'
  .byte $41, $7f, $7f, $09, $19, $7f, $66, $00 ;  82 $52 'R'
  .byte $26, $6f, $4d, $59, $73, $32, $00, $00 ;  83 $53 'S'
  .byte $03, $41, $7f, $7f, $41, $03, $00, $00 ;  84 $54 'T'
  .byte $7f, $7f, $40, $40, $7f, $7f, $00, $00 ;  85 $55 'U'
  .byte $1f, $3f, $60, $60, $3f, $1f, $00, $00 ;  86 $56 'V'
  .byte $7f, $7f, $30, $18, $30, $7f, $7f, $00 ;  87 $57 'W'
  .byte $43, $67, $3c, $18, $3c, $67, $43, $00 ;  88 $58 'X'
  .byte $07, $4f, $78, $78, $4f, $07, $00, $00 ;  89 $59 'Y'
  .byte $47, $63, $71, $59, $4d, $67, $73, $00 ;  90 $5a 'Z'
  .byte $00, $7f, $7f, $41, $41, $00, $00, $00 ;  91 $5b '['
  .byte $01, $03, $06, $0c, $18, $30, $60, $00 ;  92 $5c '\'
  .byte $00, $41, $41, $7f, $7f, $00, $00, $00 ;  93 $5d ']'
  .byte $08, $0c, $06, $03, $06, $0c, $08, $00 ;  94 $5e '^'
  .byte $80, $80, $80, $80, $80, $80, $80, $80 ;  95 $5f '_'
  .byte $00, $00, $03, $07, $04, $00, $00, $00 ;  96 $60 '`'
  .byte $20, $74, $54, $54, $3c, $78, $40, $00 ;  97 $61 'a'
  .byte $41, $7f, $3f, $48, $48, $78, $30, $00 ;  98 $62 'b'
  .byte $38, $7c, $44, $44, $6c, $28, $00, $00 ;  99 $63 'c'
  .byte $30, $78, $48, $49, $3f, $7f, $40, $00 ; 100 $64 'd'
  .byte $38, $7c, $54, $54, $5c, $18, $00, $00 ; 101 $65 'e'
  .byte $48, $7e, $7f, $49, $03, $02, $00, $00 ; 102 $66 'f'
  .byte $98, $bc, $a4, $a4, $f8, $7c, $04, $00 ; 103 $67 'g'
  .byte $41, $7f, $7f, $08, $04, $7c, $78, $00 ; 104 $68 'h'
  .byte $00, $44, $7d, $7d, $40, $00, $00, $00 ; 105 $69 'i'
  .byte $60, $e0, $80, $80, $fd, $7d, $00, $00 ; 106 $6a 'j'
  .byte $41, $7f, $7f, $10, $38, $6c, $44, $00 ; 107 $6b 'k'
  .byte $00, $41, $7f, $7f, $40, $00, $00, $00 ; 108 $6c 'l'
  .byte $7c, $7c, $18, $38, $1c, $7c, $78, $00 ; 109 $6d 'm'
  .byte $7c, $7c, $04, $04, $7c, $78, $00, $00 ; 110 $6e 'n'
  .byte $38, $7c, $44, $44, $7c, $38, $00, $00 ; 111 $6f 'o'
  .byte $84, $fc, $f8, $a4, $24, $3c, $18, $00 ; 112 $70 'p'
  .byte $18, $3c, $24, $a4, $f8, $fc, $84, $00 ; 113 $71 'q'
  .byte $44, $7c, $78, $4c, $04, $1c, $18, $00 ; 114 $72 'r'
  .byte $48, $5c, $54, $54, $74, $24, $00, $00 ; 115 $73 's'
  .byte $00, $04, $3e, $7f, $44, $24, $00, $00 ; 116 $74 't'
  .byte $3c, $7c, $40, $40, $3c, $7c, $40, $00 ; 117 $75 'u'
  .byte $1c, $3c, $60, $60, $3c, $1c, $00, $00 ; 118 $76 'v'
  .byte $3c, $7c, $70, $38, $70, $7c, $3c, $00 ; 119 $77 'w'
  .byte $44, $6c, $38, $10, $38, $6c, $44, $00 ; 120 $78 'x'
  .byte $9c, $bc, $a0, $a0, $fc, $7c, $00, $00 ; 121 $79 'y'
  .byte $4c, $64, $74, $5c, $4c, $64, $00, $00 ; 122 $7a 'z'
  .byte $08, $08, $3e, $77, $41, $41, $00, $00 ; 123 $7b '{'
  .byte $00, $00, $00, $77, $77, $00, $00, $00 ; 124 $7c '|'
  .byte $41, $41, $77, $3e, $08, $08, $00, $00 ; 125 $7d '}'
  .byte $02, $03, $01, $03, $02, $03, $01, $00 ; 126 $7e '~'
