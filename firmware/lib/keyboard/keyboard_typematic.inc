; Format is XX_Y meaning XX.Y for CPS (Characters Per Second)
KEYBOARD_RATE_30_0_CPS = $00
KEYBOARD_RATE_26_7_CPS = $01
KEYBOARD_RATE_24_0_CPS = $02
KEYBOARD_RATE_21_8_CPS = $03
KEYBOARD_RATE_20_7_CPS = $04
KEYBOARD_RATE_18_5_CPS = $05
KEYBOARD_RATE_17_1_CPS = $06
KEYBOARD_RATE_16_0_CPS = $07
KEYBOARD_RATE_15_0_CPS = $08
KEYBOARD_RATE_13_3_CPS = $09
KEYBOARD_RATE_12_0_CPS = $0A
KEYBOARD_RATE_10_9_CPS = $0B
KEYBOARD_RATE_10_0_CPS = $0C
KEYBOARD_RATE_9_2_CPS  = $0D
KEYBOARD_RATE_8_6_CPS  = $0E
KEYBOARD_RATE_8_0_CPS  = $0F
KEYBOARD_RATE_7_5_CPS  = $10
KEYBOARD_RATE_6_7_CPS  = $11
KEYBOARD_RATE_6_0_CPS  = $12
KEYBOARD_RATE_5_5_CPS  = $13
KEYBOARD_RATE_5_0_CPS  = $14
KEYBOARD_RATE_4_6_CPS  = $15
KEYBOARD_RATE_4_3_CPS  = $16
KEYBOARD_RATE_4_0_CPS  = $17
KEYBOARD_RATE_3_7_CPS  = $18
KEYBOARD_RATE_3_3_CPS  = $19
KEYBOARD_RATE_3_0_CPS  = $1A
KEYBOARD_RATE_2_7_CPS  = $1B
KEYBOARD_RATE_2_5_CPS  = $1C
KEYBOARD_RATE_2_3_CPS  = $1D
KEYBOARD_RATE_2_1_CPS  = $1E
KEYBOARD_RATE_2_0_CPS  = $1F

; Format is X_YY meaning X.YY for seconds delay
KEYBOARD_DELAY_0_25_S = %0000000
KEYBOARD_DELAY_0_50_S = %0100000
KEYBOARD_DELAY_0_75_S = %1000000
KEYBOARD_DELAY_1_00_S = %1100000
