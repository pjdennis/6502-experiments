; Translation tables to convert from PS/2 code set 2 to ASCII-derived code set.
kb_normal_translation_table:
  .byte $01, KEY_F9
  .byte $03, KEY_F5
  .byte $04, KEY_F3
  .byte $05, KEY_F1
  .byte $06, KEY_F2
  .byte $07, KEY_F12
  .byte $09, KEY_F10
  .byte $0a, KEY_F8
  .byte $0b, KEY_F6
  .byte $0c, KEY_F4
  .byte $0d, KEY_TAB
  .byte $0e, KEY_GRAVE
  .byte $11, KEY_LEFTALT
  .byte $12, KEY_LEFTSHIFT
  .byte $14, KEY_LEFTCTRL
  .byte $15, KEY_Q
  .byte $16, KEY_1
  .byte $1a, KEY_Z
  .byte $1b, KEY_S
  .byte $1c, KEY_A
  .byte $1d, KEY_W
  .byte $1e, KEY_2
  .byte $21, KEY_C
  .byte $22, KEY_X
  .byte $23, KEY_D
  .byte $24, KEY_E
  .byte $25, KEY_4
  .byte $26, KEY_3
  .byte $29, KEY_SPACE
  .byte $2a, KEY_V
  .byte $2b, KEY_F
  .byte $2c, KEY_T
  .byte $2d, KEY_R
  .byte $2e, KEY_5
  .byte $31, KEY_N
  .byte $32, KEY_B
  .byte $33, KEY_H
  .byte $34, KEY_G
  .byte $35, KEY_Y
  .byte $36, KEY_6
  .byte $3a, KEY_M
  .byte $3b, KEY_J
  .byte $3c, KEY_U
  .byte $3d, KEY_7
  .byte $3e, KEY_8
  .byte $41, KEY_COMMA
  .byte $42, KEY_K
  .byte $43, KEY_I
  .byte $44, KEY_O
  .byte $45, KEY_0
  .byte $46, KEY_9
  .byte $49, KEY_DOT
  .byte $4a, KEY_SLASH
  .byte $4b, KEY_L
  .byte $4c, KEY_SEMICOLON
  .byte $4d, KEY_P
  .byte $4e, KEY_MINUS
  .byte $52, KEY_APOSTROPHE
  .byte $54, KEY_LEFTBRACE
  .byte $55, KEY_EQUAL
  .byte $58, KEY_CAPSLOCK
  .byte $59, KEY_RIGHTSHIFT
  .byte $5a, KEY_ENTER
  .byte $5b, KEY_RIGHTBRACE
  .byte $5d, KEY_BACKSLASH
  .byte $66, KEY_BACKSPACE
  .byte $69, KEY_KP1
  .byte $6b, KEY_KP4
  .byte $6c, KEY_KP7
  .byte $70, KEY_KP0
  .byte $71, KEY_KPDOT
  .byte $72, KEY_KP2
  .byte $73, KEY_KP5
  .byte $74, KEY_KP6
  .byte $75, KEY_KP8
  .byte $76, KEY_ESC
  .byte $77, KEY_NUMLOCK
  .byte $78, KEY_F11
  .byte $79, KEY_KPPLUS
  .byte $7a, KEY_KP3
  .byte $7b, KEY_KPMINUS
  .byte $7c, KEY_KPASTERISK
  .byte $7d, KEY_KP9
  .byte $7e, KEY_SCROLLLOCK
  .byte $83, KEY_F7
  .byte $84, KEY_SYSRQ
  .byte $00

kb_extended_translation_table:
  .byte $11, KEY_RIGHTALT
  .byte $14, KEY_RIGHTCTRL
  .byte $15, KEY_PREVIOUSSONG
  .byte $1f, KEY_LEFTMETA
  .byte $21, KEY_VOLUMEDOWN
  .byte $23, KEY_MUTE
  .byte $27, KEY_RIGHTMETA
  .byte $2f, KEY_MENU
  .byte $32, KEY_VOLUMEUP
  .byte $34, KEY_PLAYPAUSE
  .byte $37, KEY_POWER
  .byte $3b, KEY_STOPCD
  .byte $3f, KEY_SLEEP
  .byte $4a, KEY_KPSLASH
  .byte $4d, KEY_NEXTSONG
  .byte $5a, KEY_KPENTER
  .byte $5e, KEY_WAKE
  .byte $69, KEY_END
  .byte $6b, KEY_LEFT
  .byte $6c, KEY_HOME
  .byte $70, KEY_INSERT
  .byte $71, KEY_DELETE
  .byte $72, KEY_DOWN
  .byte $74, KEY_RIGHT
  .byte $75, KEY_UP
  .byte $7a, KEY_PAGEDOWN
  .byte $7c, KEY_SYSRQ
  .byte $7d, KEY_PAGEUP
  .byte $7e, KEY_PAUSE
  .byte $00


; Translation table to convert from unshifted to shifted characters
; (excluding the alphabetic characters)
kb_shift_translation_table:
  .byte '`', '~'
  .byte '1', '!'
  .byte '2', '@'
  .byte '3', '#'
  .byte '4', '$'
  .byte '5', '%'
  .byte '6', '^'
  .byte '7', '&'
  .byte '8', '*'
  .byte '9', '('
  .byte '0', ')'
  .byte '-', '_'
  .byte '=', '+'
  .byte '[', '{'
  .byte ']', '}'
  .byte '\\', '|'
  .byte ';', ':'
  .byte "'", '"'
  .byte ',', '<'
  .byte '.', '>'
  .byte '/', '?'
  .byte $00
