key_names:
  .asciiz KEY_F1,           "F1"
  .asciiz KEY_ESC,          "ESC"
  .asciiz KEY_TAB,          "TAB"
  .asciiz KEY_GRAVE,        "GRAVE"
  .asciiz KEY_F2,           "F2"
  .asciiz KEY_LEFTCTRL,     "LEFTCTRL"
  .asciiz KEY_LEFTSHIFT,    "LEFTSHIFT"
  .asciiz KEY_CAPSLOCK,     "CAPSLOCK"
  .asciiz KEY_Q,            "Q"
  .asciiz KEY_1,            "1"
  .asciiz KEY_F3,           "F3"
  .asciiz KEY_LEFTALT,      "LEFTALT"
  .asciiz KEY_Z,            "Z"
  .asciiz KEY_S,            "S"
  .asciiz KEY_A,            "A"
  .asciiz KEY_W,            "W"
  .asciiz KEY_2,            "2"
  .asciiz KEY_F4,           "F4"
  .asciiz KEY_C,            "C"
  .asciiz KEY_X,            "X"
  .asciiz KEY_D,            "D"
  .asciiz KEY_E,            "E"
  .asciiz KEY_4,            "4"
  .asciiz KEY_3,            "3"
  .asciiz KEY_F5,           "F5"
  .asciiz KEY_SPACE,        "SPACE"
  .asciiz KEY_V,            "V"
  .asciiz KEY_F,            "F"
  .asciiz KEY_T,            "T"
  .asciiz KEY_R,            "R"
  .asciiz KEY_5,            "5"
  .asciiz KEY_F6,           "F6"
  .asciiz KEY_N,            "N"
  .asciiz KEY_B,            "B"
  .asciiz KEY_H,            "H"
  .asciiz KEY_G,            "G"
  .asciiz KEY_Y,            "Y"
  .asciiz KEY_6,            "6"
  .asciiz KEY_F7,           "F7"
  .asciiz KEY_RIGHTALT,     "RIGHTALT"
  .asciiz KEY_M,            "M"
  .asciiz KEY_J,            "J"
  .asciiz KEY_U,            "U"
  .asciiz KEY_7,            "7"
  .asciiz KEY_8,            "8"
  .asciiz KEY_F8,           "F8"
  .asciiz KEY_COMMA,        "COMMA"
  .asciiz KEY_K,            "K"
  .asciiz KEY_I,            "I"
  .asciiz KEY_O,            "O"
  .asciiz KEY_0,            "0"
  .asciiz KEY_9,            "9"
  .asciiz KEY_F9,           "F9"
  .asciiz KEY_DOT,          "DOT"
  .asciiz KEY_SLASH,        "SLASH"
  .asciiz KEY_L,            "L"
  .asciiz KEY_SEMICOLON,    "SEMICOLON"
  .asciiz KEY_P,            "P"
  .asciiz KEY_MINUS,        "MINUS"
  .asciiz KEY_F10,          "F10"
  .asciiz KEY_APOSTROPHE,   "APOSTROPHE"
  .asciiz KEY_LEFTBRACE,    "LEFTBRACE"
  .asciiz KEY_EQUAL,        "EQUAL"
  .asciiz KEY_F11,          "F11"
  .asciiz KEY_SYSRQ,        "SYSRQ"
  .asciiz KEY_RIGHTCTRL,    "RIGHTCTRL"
  .asciiz KEY_RIGHTSHIFT,   "RIGHTSHIFT"
  .asciiz KEY_ENTER,        "ENTER"
  .asciiz KEY_RIGHTBRACE,   "RIGHTBRACE"
  .asciiz KEY_BACKSLASH,    "BACKSLASH"
  .asciiz KEY_F12,          "F12"
  .asciiz KEY_SCROLLLOCK,   "SCROLLLOCK"
  .asciiz KEY_DOWN,         "DOWN"
  .asciiz KEY_LEFT,         "LEFT"
  .asciiz KEY_PAUSE,        "PAUSE"
  .asciiz KEY_UP,           "UP"
  .asciiz KEY_DELETE,       "DELETE"
  .asciiz KEY_END,          "END"
  .asciiz KEY_BACKSPACE,    "BACKSPACE"
  .asciiz KEY_INSERT,       "INSERT"
  .asciiz KEY_KP1,          "KP1"
  .asciiz KEY_RIGHT,        "RIGHT"
  .asciiz KEY_KP4,          "KP4"
  .asciiz KEY_KP7,          "KP7"
  .asciiz KEY_PAGEDOWN,     "PAGEDOWN"
  .asciiz KEY_HOME,         "HOME"
  .asciiz KEY_PAGEUP,       "PAGEUP"
  .asciiz KEY_KP0,          "KP0"
  .asciiz KEY_KPDOT,        "KPDOT"
  .asciiz KEY_KP2,          "KP2"
  .asciiz KEY_KP5,          "KP5"
  .asciiz KEY_KP6,          "KP6"
  .asciiz KEY_KP8,          "KP8"
  .asciiz KEY_NUMLOCK,      "NUMLOCK"
  .asciiz KEY_KPSLASH,      "KPSLASH"
  .asciiz KEY_KPENTER,      "KPENTER"
  .asciiz KEY_KP3,          "KP3"
  .asciiz KEY_KPPLUS,       "KPPLUS"
  .asciiz KEY_KP9,          "KP9"
  .asciiz KEY_KPASTERISK,   "KPASTERISK"
  .asciiz KEY_SLEEP,        "SLEEP"
  .asciiz KEY_KPMINUS,      "KPMINUS"
  .asciiz KEY_LEFTMETA,     "LEFTMETA"
  .asciiz KEY_RIGHTMETA,    "RIGHTMETA"
  .asciiz KEY_MENU,         "MENU"
  .asciiz KEY_PREVIOUSSONG, "PREVIOUSSONG"
  .asciiz KEY_PLAYPAUSE,    "PLAYPAUSE"
  .asciiz KEY_STOPCD,       "STOPCD"
  .asciiz KEY_NEXTSONG,     "NEXTSONG"
  .asciiz KEY_MUTE,         "MUTE"
  .asciiz KEY_VOLUMEDOWN,   "VOLUMEDOWN"
  .asciiz KEY_VOLUMEUP,     "VOLUMEUP"
  .byte 0
