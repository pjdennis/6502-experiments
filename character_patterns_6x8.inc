character_patterns_6x8:
  .byte $00, $00, $00, $00, $00, $00 ;  32 $20 ' '
  .byte $00, $00, $06, $5f, $06, $00 ;  33 $21 '!'
  .byte $00, $07, $03, $00, $07, $03 ;  34 $22 '"'
  .byte $00, $24, $7e, $24, $7e, $24 ;  35 $23 '#'
  .byte $00, $24, $2b, $6a, $12, $00 ;  36 $24 '$'
  .byte $00, $63, $13, $08, $64, $63 ;  37 $25 '%'
  .byte $00, $36, $49, $56, $20, $50 ;  38 $26 '&'
  .byte $00, $00, $07, $03, $00, $00 ;  39 $27 '''
  .byte $00, $00, $3e, $41, $00, $00 ;  40 $28 '('
  .byte $00, $00, $41, $3e, $00, $00 ;  41 $29 ')'
  .byte $00, $08, $3e, $1c, $3e, $08 ;  42 $2a '*'
  .byte $00, $08, $08, $3e, $08, $08 ;  43 $2b '+'
  .byte $00, $00, $e0, $60, $00, $00 ;  44 $2c ','
  .byte $00, $08, $08, $08, $08, $08 ;  45 $2d '-'
  .byte $00, $00, $60, $60, $00, $00 ;  46 $2e '.'
  .byte $00, $20, $10, $08, $04, $02 ;  47 $2f '/'
  .byte $00, $3e, $51, $49, $45, $3e ;  48 $30 '0'
  .byte $00, $00, $42, $7f, $40, $00 ;  49 $31 '1'
  .byte $00, $62, $51, $49, $49, $46 ;  50 $32 '2'
  .byte $00, $22, $49, $49, $49, $36 ;  51 $33 '3'
  .byte $00, $18, $14, $12, $7f, $10 ;  52 $34 '4'
  .byte $00, $2f, $49, $49, $49, $31 ;  53 $35 '5'
  .byte $00, $3c, $4a, $49, $49, $30 ;  54 $36 '6'
  .byte $00, $01, $71, $09, $05, $03 ;  55 $37 '7'
  .byte $00, $36, $49, $49, $49, $36 ;  56 $38 '8'
  .byte $00, $06, $49, $49, $29, $1e ;  57 $39 '9'
  .byte $00, $00, $6c, $6c, $00, $00 ;  58 $3a ':'
  .byte $00, $00, $ec, $6c, $00, $00 ;  59 $3b ';'
  .byte $00, $08, $14, $22, $41, $00 ;  60 $3c '<'
  .byte $00, $24, $24, $24, $24, $24 ;  61 $3d '='
  .byte $00, $00, $41, $22, $14, $08 ;  62 $3e '>'
  .byte $00, $02, $01, $59, $09, $06 ;  63 $3f '?'
  .byte $00, $3e, $41, $5d, $55, $1e ;  64 $40 '@'
  .byte $00, $7e, $11, $11, $11, $7e ;  65 $41 'A'
  .byte $00, $7f, $49, $49, $49, $36 ;  66 $42 'B'
  .byte $00, $3e, $41, $41, $41, $22 ;  67 $43 'C'
  .byte $00, $7f, $41, $41, $41, $3e ;  68 $44 'D'
  .byte $00, $7f, $49, $49, $49, $41 ;  69 $45 'E'
  .byte $00, $7f, $09, $09, $09, $01 ;  70 $46 'F'
  .byte $00, $3e, $41, $49, $49, $7a ;  71 $47 'G'
  .byte $00, $7f, $08, $08, $08, $7f ;  72 $48 'H'
  .byte $00, $00, $41, $7f, $41, $00 ;  73 $49 'I'
  .byte $00, $30, $40, $40, $40, $3f ;  74 $4a 'J'
  .byte $00, $7f, $08, $14, $22, $41 ;  75 $4b 'K'
  .byte $00, $7f, $40, $40, $40, $40 ;  76 $4c 'L'
  .byte $00, $7f, $02, $04, $02, $7f ;  77 $4d 'M'
  .byte $00, $7f, $02, $04, $08, $7f ;  78 $4e 'N'
  .byte $00, $3e, $41, $41, $41, $3e ;  79 $4f 'O'
  .byte $00, $7f, $09, $09, $09, $06 ;  80 $50 'P'
  .byte $00, $3e, $41, $51, $21, $5e ;  81 $51 'Q'
  .byte $00, $7f, $09, $09, $19, $66 ;  82 $52 'R'
  .byte $00, $26, $49, $49, $49, $32 ;  83 $53 'S'
  .byte $00, $01, $01, $7f, $01, $01 ;  84 $54 'T'
  .byte $00, $3f, $40, $40, $40, $3f ;  85 $55 'U'
  .byte $00, $1f, $20, $40, $20, $1f ;  86 $56 'V'
  .byte $00, $3f, $40, $3c, $40, $3f ;  87 $57 'W'
  .byte $00, $63, $14, $08, $14, $63 ;  88 $58 'X'
  .byte $00, $07, $08, $70, $08, $07 ;  89 $59 'Y'
  .byte $00, $71, $49, $45, $43, $00 ;  90 $5a 'Z'
  .byte $00, $00, $7f, $41, $41, $00 ;  91 $5b '['
  .byte $00, $02, $04, $08, $10, $20 ;  92 $5c '\'
  .byte $00, $00, $41, $41, $7f, $00 ;  93 $5d ']'
  .byte $00, $04, $02, $01, $02, $04 ;  94 $5e '^'
  .byte $80, $80, $80, $80, $80, $80 ;  95 $5f '_'
  .byte $00, $00, $03, $07, $00, $00 ;  96 $60 '`'
  .byte $00, $20, $54, $54, $54, $78 ;  97 $61 'a'
  .byte $00, $7f, $44, $44, $44, $38 ;  98 $62 'b'
  .byte $00, $38, $44, $44, $44, $28 ;  99 $63 'c'
  .byte $00, $38, $44, $44, $44, $7f ; 100 $64 'd'
  .byte $00, $38, $54, $54, $54, $08 ; 101 $65 'e'
  .byte $00, $08, $7e, $09, $09, $00 ; 102 $66 'f'
  .byte $00, $18, $a4, $a4, $a4, $7c ; 103 $67 'g'
  .byte $00, $7f, $04, $04, $78, $00 ; 104 $68 'h'
  .byte $00, $00, $00, $7d, $40, $00 ; 105 $69 'i'
  .byte $00, $40, $80, $84, $7d, $00 ; 106 $6a 'j'
  .byte $00, $7f, $10, $28, $44, $00 ; 107 $6b 'k'
  .byte $00, $00, $00, $7f, $40, $00 ; 108 $6c 'l'
  .byte $00, $7c, $04, $18, $04, $78 ; 109 $6d 'm'
  .byte $00, $7c, $04, $04, $78, $00 ; 110 $6e 'n'
  .byte $00, $38, $44, $44, $44, $38 ; 111 $6f 'o'
  .byte $00, $fc, $44, $44, $44, $38 ; 112 $70 'p'
  .byte $00, $38, $44, $44, $44, $fc ; 113 $71 'q'
  .byte $00, $44, $78, $44, $04, $08 ; 114 $72 'r'
  .byte $00, $08, $54, $54, $54, $20 ; 115 $73 's'
  .byte $00, $04, $3e, $44, $24, $00 ; 116 $74 't'
  .byte $00, $3c, $40, $20, $7c, $00 ; 117 $75 'u'
  .byte $00, $1c, $20, $40, $20, $1c ; 118 $76 'v'
  .byte $00, $3c, $60, $30, $60, $3c ; 119 $77 'w'
  .byte $00, $6c, $10, $10, $6c, $00 ; 120 $78 'x'
  .byte $00, $9c, $a0, $60, $3c, $00 ; 121 $79 'y'
  .byte $00, $64, $54, $54, $4c, $00 ; 122 $7a 'z'
  .byte $00, $08, $3e, $41, $41, $00 ; 123 $7b '{'
  .byte $00, $00, $00, $77, $00, $00 ; 124 $7c '|'
  .byte $00, $00, $41, $41, $3e, $08 ; 125 $7d '}'
  .byte $00, $02, $01, $02, $01, $00 ; 126 $7e '~'
