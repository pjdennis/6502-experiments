; w65c02 assembly code for 't4_bank_counters'
; generated by prog8.codegen.cpu6502.ProgramAndVarsGen on 2026-06-06T19:00
; assembler syntax is for the 64tasm cross-assembler
; output options: output=RAW launcher=NONE zp=KERNALSAFE

.cpu  'w65c02'
.enc  'none'
P8ZP_SCRATCH_B1 = 250
P8ZP_SCRATCH_REG = 251
P8ZP_SCRATCH_W1 = 252    ; word
P8ZP_SCRATCH_W2 = 254    ; word
P8ZP_SCRATCH_PTR = 248  ; word
.weak
.endweak
; ---- raw assembler program ----
* = $4000
prog8_program_start	; start of program label
	cld
	tsx  ; save stackpointer for sys.exit()
	stx  prog8_lib.orig_stackpointer
	jsr  p8_sys_startup.init_system
	jsr  p8_sys_startup.init_system_phase2
	; zeropage is clobbered so we need to reset the machine at exit
	lda  #>sys.reset_system
	pha
	lda  #<sys.reset_system
	pha
	jsr  p8b_main.p8s_start
	jmp  p8_sys_startup.cleanup_at_exit

; ---- block: 'p8b_main' ----
p8b_main	.proc
	; source: demos/t4_bank_counters.p8:7   main {


	; source: demos/t4_bank_counters.p8:8   sub start() {

p8s_start	.proc
p8v_pass 	= 52 	; zp ubyte
p8v_c 	= 53 	; zp ubyte
p8v_b 	= 54 	; zp ubyte
	jsr  prog8_lib.program_startup_clear_bss
+
; statements
	; source: demos/t4_bank_counters.p8:17   ubyte c = banking.bank_peek(b, $a010)
	; source: demos/t4_bank_counters.p8:10   ubyte b
	; source: demos/t4_bank_counters.p8:14   ubyte pass
	; source: demos/t4_bank_counters.p8:9   txt.clear()
	jsr  txt.clear
	; source: demos/t4_bank_counters.p8:11   for b in 0 to 7 {
	lda  #0
	sta  p8v_b
p8_label_gen_6_for_loop
	; source: demos/t4_bank_counters.p8:12   banking.bank_poke(b, $a010, 0)
	lda  p8v_b
	sta  banking.bank_poke.n
	lda  #<$a010
	ldy  #>$a010
	sta  banking.bank_poke.win
	sty  banking.bank_poke.win+1
	stz  banking.bank_poke.val
	jsr  banking.bank_poke
	inc  p8v_b
	lda  p8v_b
	cmp  #8
	bne  p8_label_gen_6_for_loop
p8_label_gen_7_for_end
	; source: demos/t4_bank_counters.p8:15   for pass in 0 to 2 {
	lda  #0
	sta  p8v_pass
p8_label_gen_8_for_loop
	; source: demos/t4_bank_counters.p8:16   for b in 0 to 7 {
	lda  #0
	sta  p8v_b
p8_label_gen_10_for_loop
	; source: demos/t4_bank_counters.p8:17   ubyte c = banking.bank_peek(b, $a010)
	lda  p8v_b
	sta  banking.bank_peek.n
	lda  #<$a010
	ldy  #>$a010
	sta  banking.bank_peek.win
	sty  banking.bank_peek.win+1
	jsr  banking.bank_peek
	sta  p8v_c
	; source: demos/t4_bank_counters.p8:18   banking.bank_poke(b, $a010, c + 1)
	lda  p8v_b
	sta  banking.bank_poke.n
	lda  #<$a010
	ldy  #>$a010
	sta  banking.bank_poke.win
	sty  banking.bank_poke.win+1
	lda  p8v_c
	inc  a
	sta  banking.bank_poke.val
	jsr  banking.bank_poke
	inc  p8v_b
	lda  p8v_b
	cmp  #8
	bne  p8_label_gen_10_for_loop
p8_label_gen_11_for_end
	inc  p8v_pass
	lda  p8v_pass
	cmp  #3
	bne  p8_label_gen_8_for_loop
p8_label_gen_9_for_end
	; source: demos/t4_bank_counters.p8:21   txt.print("counters:")
	ldy  #>prog8_interned_strings.string_1
	lda  #<prog8_interned_strings.string_1
	jsr  txt.print
	; source: demos/t4_bank_counters.p8:22   txt.line2()
	jsr  txt.line2
	; source: demos/t4_bank_counters.p8:23   for b in 0 to 7 {
	lda  #0
	sta  p8v_b
p8_label_gen_12_for_loop
	; source: demos/t4_bank_counters.p8:24   txt.chrout($30 + banking.bank_peek(b, $a010))   ; '0'+count
	lda  p8v_b
	sta  banking.bank_peek.n
	lda  #<$a010
	ldy  #>$a010
	sta  banking.bank_peek.win
	sty  banking.bank_peek.win+1
	jsr  banking.bank_peek
	clc
	adc  #$30
	jsr  txt.chrout
	inc  p8v_b
	lda  p8v_b
	cmp  #8
	bne  p8_label_gen_12_for_loop
p8_label_gen_13_for_end
	rts
; variables
	.section BSS_NOCLEAR
	.send BSS_NOCLEAR

	.pend
	.pend

; ---- block: 'p8_sys_startup' ----
p8_sys_startup	.proc
	; source: libraries/wendy2/syslib.p8:374   p8_sys_startup {


	; source: libraries/wendy2/syslib.p8:377   asmsub  init_system()  {

init_system	.proc
	; source: libraries/wendy2/syslib.p8:380   %asm {{
            sei
            cld
            clc
            ; TODO reset screen mode etc etc?
            clv
            ; TODO what about IRQ handler?  cli
            rts
	.pend
	; source: libraries/wendy2/syslib.p8:391   asmsub  init_system_phase2()  {

init_system_phase2	.proc
	; source: libraries/wendy2/syslib.p8:392   %asm {{
            rts     ; no phase 2 steps on the Neo6502
	.pend
	; source: libraries/wendy2/syslib.p8:397   asmsub  cleanup_at_exit() {

cleanup_at_exit	.proc
	; source: libraries/wendy2/syslib.p8:403   %asm {{
            lda  $02ff
            cmp  #$a5
            beq  $0320          ; return to the boot monitor
+           lda  _exitcode
            stp

            .section BSS
_exitcarry  .byte ?
_exitcode   .byte ?
_exitcodeX  .byte ?
_exitcodeY  .byte ?
            .send BSS

            ; !notreached!
	.pend
	.pend

; ---- block: 'prog8_interned_strings' ----
prog8_interned_strings	.proc

; non-zeropage variables with init value
string_1	; CP437:"counters:"
	.byte  $63, $6f, $75, $6e, $74, $65, $72, $73, $3a, $00

	; source: demos/t4_bank_counters.p8:21   txt.print("counters:")
	.pend

; ---- block: 'txt' ----
txt	.proc
	; source: libraries/wendy2/textio.p8:14   txt {


	; source: libraries/wendy2/textio.p8:15   sub clear() {

clear	.proc
; statements
	; source: libraries/wendy2/textio.p8:16   send_byte($01, 0)                   ; CMD_CLEAR_DISPLAY
	ldx  #0
	lda  #1
	jmp  txt.send_byte
; variables
	.section BSS_NOCLEAR
	.send BSS_NOCLEAR

	.pend
	; source: libraries/wendy2/textio.p8:23   sub line2() {

line2	.proc
; statements
	; source: libraries/wendy2/textio.p8:24   send_byte($c0, 0)                   ; SET_DDRAM | $40 (second line)
	ldx  #0
	lda  #$c0
	jmp  txt.send_byte
; variables
	.section BSS_NOCLEAR
	.send BSS_NOCLEAR

	.pend
	; source: libraries/wendy2/textio.p8:27   sub chrout(ubyte char) {

chrout	.proc
char 	= 51 	; zp ubyte
; simple int arg(s) passed via cpu register(s)
	sta  char
; statements
	; source: libraries/wendy2/textio.p8:28   send_byte(char, $01)                ; RS=1 -> write to DDRAM (a glyph)
	ldx  #1
	lda  char
	jmp  txt.send_byte
; variables
	.section BSS_NOCLEAR
	.send BSS_NOCLEAR

	.pend
	; source: libraries/wendy2/textio.p8:31   sub print(str s) {

print	.proc
s 	= 48 	; zp ^^ubyte
i 	= 50 	; zp ubyte
; simple int arg(s) passed via cpu register(s)
	sta  s
	sty  s+1
; statements
	; source: libraries/wendy2/textio.p8:32   ubyte i = 0
	stz  i
	; source: libraries/wendy2/textio.p8:33   while s[i] != 0 {
p8_label_gen_1_whileloop
	ldy  i
	lda  (s),y
	beq  p8_label_gen_2_afterwhile
	; source: libraries/wendy2/textio.p8:34   send_byte(s[i], $01)
	ldx  #1
	ldy  i
	lda  (s),y
	jsr  txt.send_byte
	; source: libraries/wendy2/textio.p8:35   i++
	inc  i
	; source: libraries/wendy2/textio.p8:33   while s[i] != 0 {
	bra  p8_label_gen_1_whileloop
p8_label_gen_2_afterwhile
	rts
; variables
	.section BSS_NOCLEAR
	.send BSS_NOCLEAR

	.pend
	; source: libraries/wendy2/textio.p8:53   asmsub send_byte(ubyte value @A, ubyte rsflag @X) clobbers(A,X,Y) {

send_byte	.proc
	; source: libraries/wendy2/textio.p8:54   %asm {{
            phy
            jsr  _wait              ; wait until not busy (preserves A? no -> save)
            pha
            asl  a                  ; lower nibble -> PORTA bits 7-4
            asl  a
            asl  a
            asl  a
            and  #$f0
            tay                     ; Y = second (low) nibble, positioned
            pla
            and  #$f0               ; A = first (high) nibble, already positioned
            tsb  $f001              ; PORTA: drive first nibble
            txa                     ; RS flag
            tsb  $f001              ; PORTA: set RS (or nothing for command)
            lda  #$20               ; E
            tsb  $f000              ; PORTB: E high
            trb  $f000              ; PORTB: E low (latch nibble)
            lda  #$f0
            trb  $f001              ; clear data lines
            tya
            tsb  $f001              ; PORTA: drive second nibble
            lda  #$20
            tsb  $f000              ; E high
            trb  $f000              ; E low (latch nibble)
            lda  #$f9               ; DISPLAY_BITS_MASK
            trb  $f001              ; clear data + RW + RS
            ply
            rts

_wait:
            pha                     ; preserve the byte to write across the poll
            phy                     ; (X/RS is untouched here -- poll reads via Y)
_busy:
            lda  #$f0
            trb  $f003              ; DDRA: data pins -> input
            lda  #$08               ; RW = read
            tsb  $f001
            lda  #$20               ; E
            tsb  $f000              ; E high
            ldy  $f001              ; read PORTA (BF in bit 7) into Y
            trb  $f000              ; E low (first nibble)
            tsb  $f000              ; E high
            trb  $f000              ; E low (second nibble, discarded)
            lda  #$f9
            trb  $f001              ; clear RW + data
            lda  #$f0
            tsb  $f003              ; DDRA: data pins -> output
            tya
            and  #$80               ; BF
            bne  _busy
            ply
            pla                     ; restore the byte to write
            rts
	.pend
	.pend

; ---- block: 'banking' ----
banking	.proc
	; source: libraries/wendy2/banking.p8:15   banking {

; non-zeropage variables with init value
cfgtab	.byte  $01, $11, $12, $13, $14, $15, $16, $17

	; source: libraries/wendy2/banking.p8:17   ubyte[8] cfgtab = [$01, $11, $12, $13, $14, $15, $16, $17]
	; source: libraries/wendy2/banking.p8:15   banking {
	; source: libraries/wendy2/banking.p8:20   sub set_raw(ubyte cfg) {

set_raw	.proc
cfg 	= 55 	; zp ubyte
; simple int arg(s) passed via cpu register(s)
	sta  cfg
; statements
	; source: libraries/wendy2/banking.p8:21   @($f000) = (@($f000) & $e0) | cfg
	lda  $f000
	and  #$e0
	ora  cfg
	sta  $f000
	rts
; variables
	.section BSS_NOCLEAR
	.send BSS_NOCLEAR

	.pend
	; source: libraries/wendy2/banking.p8:25   sub get_raw() -> ubyte {

get_raw	.proc
; statements
	; source: libraries/wendy2/banking.p8:26   return @($f000) & $1f
	lda  $f000
	and  #$1f
	rts
; variables
	.section BSS_NOCLEAR
	.send BSS_NOCLEAR

	.pend
	; source: libraries/wendy2/banking.p8:36   sub bank_peek(ubyte n, uword win) -> ubyte {

bank_peek	.proc
win 	= 61 	; zp uword
v 	= 63 	; zp ubyte
saved 	= 64 	; zp ubyte
n 	= 65 	; zp ubyte
; statements
	; source: libraries/wendy2/banking.p8:37   ubyte saved = get_raw()
	; source: libraries/wendy2/banking.p8:39   ubyte v = @(win)
	; source: libraries/wendy2/banking.p8:37   ubyte saved = get_raw()
	jsr  banking.get_raw
	sta  saved
	; source: libraries/wendy2/banking.p8:38   set_raw(cfgtab[n])
	ldy  n
	lda  banking.cfgtab,y
	jsr  banking.set_raw
	; source: libraries/wendy2/banking.p8:39   ubyte v = @(win)
	lda  (win)
	sta  v
	; source: libraries/wendy2/banking.p8:40   set_raw(saved)
	lda  saved
	jsr  banking.set_raw
	; source: libraries/wendy2/banking.p8:41   return v
	lda  v
	rts
; variables
	.section BSS_NOCLEAR
	.send BSS_NOCLEAR

	.pend
	; source: libraries/wendy2/banking.p8:46   sub bank_poke(ubyte n, uword win, ubyte val) {

bank_poke	.proc
win 	= 56 	; zp uword
val 	= 58 	; zp ubyte
saved 	= 59 	; zp ubyte
n 	= 60 	; zp ubyte
; statements
	; source: libraries/wendy2/banking.p8:47   ubyte saved = get_raw()
	jsr  banking.get_raw
	sta  saved
	; source: libraries/wendy2/banking.p8:48   set_raw(cfgtab[n])
	ldy  n
	lda  banking.cfgtab,y
	jsr  banking.set_raw
	; source: libraries/wendy2/banking.p8:49   @(win) = val
	lda  val
	sta  (win)
	; source: libraries/wendy2/banking.p8:50   set_raw(saved)
	lda  saved
	jmp  banking.set_raw
; variables
	.section BSS_NOCLEAR
	.send BSS_NOCLEAR

	.pend
	; source: libraries/wendy2/banking.p8:84   asmsub call_indirect(uword addr @AY) -> ubyte @A {

call_indirect	.proc
	; source: libraries/wendy2/banking.p8:85   %asm {{
            sta  cx16.r15
            sty  cx16.r15+1
            jmp  (cx16.r15)     ; callee's RTS returns to callfar (our caller)
	.pend
	.pend

; ---- block: 'sys' ----
sys	.proc
	; source: libraries/wendy2/syslib.p8:12   sys {
	MAX_BYTE = $7f
	MAX_UBYTE = $ff
	MAX_UWORD = $ffff
	MAX_WORD = $7fff
	MIN_BYTE = -$80
	MIN_UBYTE = 0
	MIN_UWORD = 0
	MIN_WORD = -$8000
	SIZEOF_BOOL = 1
	SIZEOF_BYTE = 1
	SIZEOF_FLOAT = 0
	SIZEOF_LONG = 4
	SIZEOF_POINTER = 2
	SIZEOF_UBYTE = 1
	SIZEOF_UWORD = 2
	SIZEOF_WORD = 2
	target = 7


	; source: libraries/wendy2/syslib.p8:15   const ubyte target = 7         ;  compilation target specifier.  255=virtual, 128=C128, 64=C64, 32=PET, 16=CommanderX16, 8=atari800XL, 7=Neo6502
	; source: libraries/wendy2/syslib.p8:17   const ubyte SIZEOF_BOOL  = sizeof(bool)
	; source: libraries/wendy2/syslib.p8:18   const ubyte SIZEOF_BYTE  = sizeof(byte)
	; source: libraries/wendy2/syslib.p8:19   const ubyte SIZEOF_UBYTE = sizeof(ubyte)
	; source: libraries/wendy2/syslib.p8:20   const ubyte SIZEOF_WORD  = sizeof(word)
	; source: libraries/wendy2/syslib.p8:21   const ubyte SIZEOF_UWORD = sizeof(uword)
	; source: libraries/wendy2/syslib.p8:22   const ubyte SIZEOF_LONG  = sizeof(long)
	; source: libraries/wendy2/syslib.p8:23   const ubyte SIZEOF_POINTER = sizeof(&sys.wait)
	; source: libraries/wendy2/syslib.p8:24   const ubyte SIZEOF_FLOAT = 0    ; undefined, no floats supported
	; source: libraries/wendy2/syslib.p8:25   const byte  MIN_BYTE     = -128
	; source: libraries/wendy2/syslib.p8:26   const byte  MAX_BYTE     = 127
	; source: libraries/wendy2/syslib.p8:27   const ubyte MIN_UBYTE    = 0
	; source: libraries/wendy2/syslib.p8:28   const ubyte MAX_UBYTE    = 255
	; source: libraries/wendy2/syslib.p8:29   const word  MIN_WORD     = -32768
	; source: libraries/wendy2/syslib.p8:30   const word  MAX_WORD     = 32767
	; source: libraries/wendy2/syslib.p8:31   const uword MIN_UWORD    = 0
	; source: libraries/wendy2/syslib.p8:32   const uword MAX_UWORD    = 65535
	; source: libraries/wendy2/syslib.p8:12   sys {
	; source: libraries/wendy2/syslib.p8:36   asmsub  reset_system()  {

reset_system	.proc
	; source: libraries/wendy2/syslib.p8:39   %asm {{
            sei
            jmp  ($fffc)
	.pend
	; source: libraries/wendy2/syslib.p8:50   asmsub waitvsync() clobbers(A) {

waitvsync	.proc
	; source: libraries/wendy2/syslib.p8:53   %asm {{
            nop
            rts
	.pend
	; source: libraries/wendy2/syslib.p8:67   asmsub exit(ubyte returnvalue @A) {

exit	.proc
	; source: libraries/wendy2/syslib.p8:69   %asm {{
            sta  p8_sys_startup.cleanup_at_exit._exitcode
            ldx  prog8_lib.orig_stackpointer
            txs
            jmp  p8_sys_startup.cleanup_at_exit
	.pend
	; source: libraries/wendy2/syslib.p8:77   asmsub exit2(ubyte resulta @A, ubyte resultx @X, ubyte resulty @Y) {

exit2	.proc
	; source: libraries/wendy2/syslib.p8:79   %asm {{
            sta  p8_sys_startup.cleanup_at_exit._exitcode
            stx  p8_sys_startup.cleanup_at_exit._exitcodeX
            sty  p8_sys_startup.cleanup_at_exit._exitcodeY
            ldx  prog8_lib.orig_stackpointer
            txs
            jmp  p8_sys_startup.cleanup_at_exit
	.pend
	; source: libraries/wendy2/syslib.p8:89   asmsub exit3(ubyte resulta @A, ubyte resultx @X, ubyte resulty @Y, bool carry @Pc) {

exit3	.proc
	; source: libraries/wendy2/syslib.p8:91   %asm {{
            sta  p8_sys_startup.cleanup_at_exit._exitcode
            lda  #0
            rol  a
            sta  p8_sys_startup.cleanup_at_exit._exitcarry
            stx  p8_sys_startup.cleanup_at_exit._exitcodeX
            sty  p8_sys_startup.cleanup_at_exit._exitcodeY
            ldx  prog8_lib.orig_stackpointer
            txs
            jmp  p8_sys_startup.cleanup_at_exit
	.pend
	; source: libraries/wendy2/syslib.p8:104   inline asmsub push(ubyte value @A) {
	; source: libraries/wendy2/syslib.p8:110   inline asmsub pushw(uword value @AY) {
	; source: libraries/wendy2/syslib.p8:118   inline asmsub push_returnaddress(uword address @XY) {
	; source: libraries/wendy2/syslib.p8:132   asmsub get_as_returnaddress(uword address @XY) -> uword @AX {

get_as_returnaddress	.proc
	; source: libraries/wendy2/syslib.p8:133   %asm {{
            ; return the address like JSR would push onto the stack:  address-1,  MSB first then LSB
            cpx  #0
            bne  +
            dey
+           dex
            tya
            rts
	.pend
	; source: libraries/wendy2/syslib.p8:144   inline asmsub pop() -> ubyte @A {
	; source: libraries/wendy2/syslib.p8:150   inline asmsub popw() -> uword @AY {
	; source: libraries/wendy2/syslib.p8:158   inline asmsub pushl(long value @R0R1) {
	; source: libraries/wendy2/syslib.p8:171   inline asmsub popl() -> long @R0R1 {
	; source: library:/prog8lib/shared_sys_functions.p8:6   asmsub save_prog8_internals() {

save_prog8_internals	.proc
	; source: library:/prog8lib/shared_sys_functions.p8:7   %asm {{
            lda  P8ZP_SCRATCH_B1
            sta  save_SCRATCH_ZPB1
            lda  P8ZP_SCRATCH_REG
            sta  save_SCRATCH_ZPREG
            lda  P8ZP_SCRATCH_W1
            sta  save_SCRATCH_ZPWORD1
            lda  P8ZP_SCRATCH_W1+1
            sta  save_SCRATCH_ZPWORD1+1
            lda  P8ZP_SCRATCH_W2
            sta  save_SCRATCH_ZPWORD2
            lda  P8ZP_SCRATCH_W2+1
            sta  save_SCRATCH_ZPWORD2+1
            lda  P8ZP_SCRATCH_PTR
            sta  save_SCRATCH_PTR
            lda  P8ZP_SCRATCH_PTR+1
            sta  save_SCRATCH_PTR+1
            rts
            .section BSS
save_SCRATCH_ZPB1	.byte  ?
save_SCRATCH_ZPREG	.byte  ?
save_SCRATCH_ZPWORD1	.word  ?
save_SCRATCH_ZPWORD2	.word  ?
save_SCRATCH_PTR	.word  ?
            .send BSS
            ; !notreached!
	.pend
	; source: library:/prog8lib/shared_sys_functions.p8:36   asmsub restore_prog8_internals() {

restore_prog8_internals	.proc
	; source: library:/prog8lib/shared_sys_functions.p8:37   %asm {{
            lda  save_prog8_internals.save_SCRATCH_ZPB1
            sta  P8ZP_SCRATCH_B1
            lda  save_prog8_internals.save_SCRATCH_ZPREG
            sta  P8ZP_SCRATCH_REG
            lda  save_prog8_internals.save_SCRATCH_ZPWORD1
            sta  P8ZP_SCRATCH_W1
            lda  save_prog8_internals.save_SCRATCH_ZPWORD1+1
            sta  P8ZP_SCRATCH_W1+1
            lda  save_prog8_internals.save_SCRATCH_ZPWORD2
            sta  P8ZP_SCRATCH_W2
            lda  save_prog8_internals.save_SCRATCH_ZPWORD2+1
            sta  P8ZP_SCRATCH_W2+1
            lda  save_prog8_internals.save_SCRATCH_PTR
            sta  P8ZP_SCRATCH_PTR
            lda  save_prog8_internals.save_SCRATCH_PTR+1
            sta  P8ZP_SCRATCH_PTR+1
            rts
	.pend
	; source: library:/prog8lib/shared_sys_functions.p8:58   asmsub internal_stringcopy(str source @R0, str target @AY) clobbers (A,Y) {

internal_stringcopy	.proc
	; source: library:/prog8lib/shared_sys_functions.p8:60   %asm {{
		sta  P8ZP_SCRATCH_W1
		sty  P8ZP_SCRATCH_W1+1
		lda  cx16.r0
		ldy  cx16.r0+1
		jmp  prog8_lib.strcpy
	.pend
	; source: library:/prog8lib/shared_sys_functions.p8:69   asmsub memcopy(uword source @R0, uword target @R1, uword count @AY) clobbers(A,X,Y) {

memcopy	.proc
	; source: library:/prog8lib/shared_sys_functions.p8:74   %asm {{
            ldx  cx16.r0
            stx  P8ZP_SCRATCH_W1        ; source in ZP
            ldx  cx16.r0+1
            stx  P8ZP_SCRATCH_W1+1
            ldx  cx16.r1
            stx  P8ZP_SCRATCH_W2        ; target in ZP
            ldx  cx16.r1+1
            stx  P8ZP_SCRATCH_W2+1
            cpy  #0
            bne  _longcopy

            ; copy <= 255 bytes
            tay
            bne  _copyshort
            rts     ; nothing to copy

_copyshort
            dey
            beq  +
-           lda  (P8ZP_SCRATCH_W1),y
            sta  (P8ZP_SCRATCH_W2),y
            dey
            bne  -
+           lda  (P8ZP_SCRATCH_W1),y
            sta  (P8ZP_SCRATCH_W2),y
            rts

_longcopy
            sta  P8ZP_SCRATCH_B1        ; lsb(count) = remainder in last page
            tya
            tax                         ; x = num pages (1+)
            ldy  #0
-           lda  (P8ZP_SCRATCH_W1),y
            sta  (P8ZP_SCRATCH_W2),y
            iny
            bne  -
            inc  P8ZP_SCRATCH_W1+1
            inc  P8ZP_SCRATCH_W2+1
            dex
            bne  -
            ldy  P8ZP_SCRATCH_B1
            bne  _copyshort
            rts
	.pend
	; source: library:/prog8lib/shared_sys_functions.p8:121   asmsub memset(uword mem @R0, uword numbytes @R1, ubyte value @A) clobbers(A,X,Y) {

memset	.proc
	; source: library:/prog8lib/shared_sys_functions.p8:122   %asm {{
            ldy  cx16.r0
            sty  P8ZP_SCRATCH_W1
            ldy  cx16.r0+1
            sty  P8ZP_SCRATCH_W1+1
            ldx  cx16.r1
            ldy  cx16.r1+1
            jmp  prog8_lib.memset
	.pend
	; source: library:/prog8lib/shared_sys_functions.p8:133   asmsub memsetw(uword mem @R0, uword numwords @R1, uword value @AY) clobbers (A,X,Y) {

memsetw	.proc
	; source: library:/prog8lib/shared_sys_functions.p8:134   %asm {{
            ldx  cx16.r0
            stx  P8ZP_SCRATCH_W1
            ldx  cx16.r0+1
            stx  P8ZP_SCRATCH_W1+1
            ldx  cx16.r1
            stx  P8ZP_SCRATCH_W2
            ldx  cx16.r1+1
            stx  P8ZP_SCRATCH_W2+1
            jmp  prog8_lib.memsetw
	.pend
	; source: library:/prog8lib/shared_sys_functions.p8:147   asmsub memcmp(uword address1 @R0, uword address2 @R1, uword size @AY) -> byte @A {

memcmp	.proc
	; source: library:/prog8lib/shared_sys_functions.p8:150   %asm {{
            sta  P8ZP_SCRATCH_W1
            sty  P8ZP_SCRATCH_W1+1
            ldx  P8ZP_SCRATCH_W1+1
            beq  _no_msb_size

_loop_msb_size
            ldy  #0
-           lda  (cx16.r0),y
            cmp  (cx16.r1),y
            bcs  +
            lda  #-1
            rts
+           beq  +
            lda  #1
            rts
+           iny
            bne  -
            inc  cx16.r0+1
            inc  cx16.r1+1
            dec  P8ZP_SCRATCH_W1+1
            dex
            bne  _loop_msb_size

_no_msb_size
            lda  P8ZP_SCRATCH_W1
            bne  +
            rts

+           ldy  #0
-           lda  (cx16.r0),y
            cmp  (cx16.r1),y
            bcs  +
            lda  #-1
            rts
+           beq  +
            lda  #1
            rts
+           iny
            cpy  P8ZP_SCRATCH_W1
            bne  -

            lda #0
            rts
	.pend
	; source: library:/prog8lib/shared_sys_functions.p8:197   inline asmsub read_flags() -> ubyte @A {
	; source: library:/prog8lib/shared_sys_functions.p8:204   inline asmsub clear_carry() {
	; source: library:/prog8lib/shared_sys_functions.p8:210   inline asmsub set_carry() {
	; source: library:/prog8lib/shared_sys_functions.p8:216   inline asmsub clear_irqd() {
	; source: library:/prog8lib/shared_sys_functions.p8:222   inline asmsub set_irqd() {
	; source: library:/prog8lib/shared_sys_functions.p8:228   inline asmsub irqsafe_set_irqd() {
	; source: library:/prog8lib/shared_sys_functions.p8:235   inline asmsub irqsafe_clear_irqd() {
	; source: library:/prog8lib/shared_sys_functions.p8:241   inline asmsub progstart() -> uword @AY {
	; source: library:/prog8lib/shared_sys_functions.p8:248   inline asmsub progend() -> uword @AY {
	.pend

; ---- block: 'cx16' ----
cx16	.proc
	; source: libraries/wendy2/syslib.p8:191   cx16 {
	r0 = 2
	r0s = 2
	r0r1sl = 2
	r0L = 2
	r0sL = 2
	r0bL = 2
	r0H = 3
	r0sH = 3
	r0bH = 3
	r1 = 4
	r1s = 4
	r1L = 4
	r1sL = 4
	r1bL = 4
	r1H = 5
	r1sH = 5
	r1bH = 5
	r2 = 6
	r2s = 6
	r2r3sl = 6
	r2L = 6
	r2sL = 6
	r2bL = 6
	r2H = 7
	r2sH = 7
	r2bH = 7
	r3 = 8
	r3s = 8
	r3L = 8
	r3sL = 8
	r3bL = 8
	r3H = 9
	r3sH = 9
	r3bH = 9
	r4 = 10
	r4s = 10
	r4r5sl = 10
	r4L = 10
	r4sL = 10
	r4bL = 10
	r4H = 11
	r4sH = 11
	r4bH = 11
	r5 = 12
	r5s = 12
	r5L = 12
	r5sL = 12
	r5bL = 12
	r5H = 13
	r5sH = 13
	r5bH = 13
	r6 = 14
	r6s = 14
	r6r7sl = 14
	r6L = 14
	r6sL = 14
	r6bL = 14
	r6H = 15
	r6sH = 15
	r6bH = 15
	r7 = $10
	r7s = $10
	r7L = $10
	r7sL = $10
	r7bL = $10
	r7H = $11
	r7sH = $11
	r7bH = $11
	r8 = $12
	r8s = $12
	r8r9sl = $12
	r8L = $12
	r8sL = $12
	r8bL = $12
	r8H = $13
	r8sH = $13
	r8bH = $13
	r9 = $14
	r9s = $14
	r9L = $14
	r9sL = $14
	r9bL = $14
	r9H = $15
	r9sH = $15
	r9bH = $15
	r10 = $16
	r10s = $16
	r10r11sl = $16
	r10L = $16
	r10sL = $16
	r10bL = $16
	r10H = $17
	r10sH = $17
	r10bH = $17
	r11 = $18
	r11s = $18
	r11L = $18
	r11sL = $18
	r11bL = $18
	r11H = $19
	r11sH = $19
	r11bH = $19
	r12 = $1a
	r12s = $1a
	r12r13sl = $1a
	r12L = $1a
	r12sL = $1a
	r12bL = $1a
	r12H = $1b
	r12sH = $1b
	r12bH = $1b
	r13 = $1c
	r13s = $1c
	r13L = $1c
	r13sL = $1c
	r13bL = $1c
	r13H = $1d
	r13sH = $1d
	r13bH = $1d
	r14 = $1e
	r14s = $1e
	r14r15sl = $1e
	r14L = $1e
	r14sL = $1e
	r14bL = $1e
	r14H = $1f
	r14sH = $1f
	r14bH = $1f
	r15 = $20
	r15s = $20
	r15L = $20
	r15sL = $20
	r15bL = $20
	r15H = $21
	r15sH = $21
	r15bH = $21


	; source: libraries/wendy2/syslib.p8:193   &uword r0  = $0002
	; source: libraries/wendy2/syslib.p8:194   &uword r1  = $0004
	; source: libraries/wendy2/syslib.p8:195   &uword r2  = $0006
	; source: libraries/wendy2/syslib.p8:196   &uword r3  = $0008
	; source: libraries/wendy2/syslib.p8:197   &uword r4  = $000a
	; source: libraries/wendy2/syslib.p8:198   &uword r5  = $000c
	; source: libraries/wendy2/syslib.p8:199   &uword r6  = $000e
	; source: libraries/wendy2/syslib.p8:200   &uword r7  = $0010
	; source: libraries/wendy2/syslib.p8:201   &uword r8  = $0012
	; source: libraries/wendy2/syslib.p8:202   &uword r9  = $0014
	; source: libraries/wendy2/syslib.p8:203   &uword r10 = $0016
	; source: libraries/wendy2/syslib.p8:204   &uword r11 = $0018
	; source: libraries/wendy2/syslib.p8:205   &uword r12 = $001a
	; source: libraries/wendy2/syslib.p8:206   &uword r13 = $001c
	; source: libraries/wendy2/syslib.p8:207   &uword r14 = $001e
	; source: libraries/wendy2/syslib.p8:208   &uword r15 = $0020
	; source: libraries/wendy2/syslib.p8:211   &word r0s  = $0002
	; source: libraries/wendy2/syslib.p8:212   &word r1s  = $0004
	; source: libraries/wendy2/syslib.p8:213   &word r2s  = $0006
	; source: libraries/wendy2/syslib.p8:214   &word r3s  = $0008
	; source: libraries/wendy2/syslib.p8:215   &word r4s  = $000a
	; source: libraries/wendy2/syslib.p8:216   &word r5s  = $000c
	; source: libraries/wendy2/syslib.p8:217   &word r6s  = $000e
	; source: libraries/wendy2/syslib.p8:218   &word r7s  = $0010
	; source: libraries/wendy2/syslib.p8:219   &word r8s  = $0012
	; source: libraries/wendy2/syslib.p8:220   &word r9s  = $0014
	; source: libraries/wendy2/syslib.p8:221   &word r10s = $0016
	; source: libraries/wendy2/syslib.p8:222   &word r11s = $0018
	; source: libraries/wendy2/syslib.p8:223   &word r12s = $001a
	; source: libraries/wendy2/syslib.p8:224   &word r13s = $001c
	; source: libraries/wendy2/syslib.p8:225   &word r14s = $001e
	; source: libraries/wendy2/syslib.p8:226   &word r15s = $0020
	; source: libraries/wendy2/syslib.p8:229   &long r0r1sl  = $0002
	; source: libraries/wendy2/syslib.p8:230   &long r2r3sl  = $0006
	; source: libraries/wendy2/syslib.p8:231   &long r4r5sl  = $000a
	; source: libraries/wendy2/syslib.p8:232   &long r6r7sl  = $000e
	; source: libraries/wendy2/syslib.p8:233   &long r8r9sl  = $0012
	; source: libraries/wendy2/syslib.p8:234   &long r10r11sl = $0016
	; source: libraries/wendy2/syslib.p8:235   &long r12r13sl = $001a
	; source: libraries/wendy2/syslib.p8:236   &long r14r15sl = $001e
	; source: libraries/wendy2/syslib.p8:239   &ubyte r0L  = $0002
	; source: libraries/wendy2/syslib.p8:240   &ubyte r1L  = $0004
	; source: libraries/wendy2/syslib.p8:241   &ubyte r2L  = $0006
	; source: libraries/wendy2/syslib.p8:242   &ubyte r3L  = $0008
	; source: libraries/wendy2/syslib.p8:243   &ubyte r4L  = $000a
	; source: libraries/wendy2/syslib.p8:244   &ubyte r5L  = $000c
	; source: libraries/wendy2/syslib.p8:245   &ubyte r6L  = $000e
	; source: libraries/wendy2/syslib.p8:246   &ubyte r7L  = $0010
	; source: libraries/wendy2/syslib.p8:247   &ubyte r8L  = $0012
	; source: libraries/wendy2/syslib.p8:248   &ubyte r9L  = $0014
	; source: libraries/wendy2/syslib.p8:249   &ubyte r10L = $0016
	; source: libraries/wendy2/syslib.p8:250   &ubyte r11L = $0018
	; source: libraries/wendy2/syslib.p8:251   &ubyte r12L = $001a
	; source: libraries/wendy2/syslib.p8:252   &ubyte r13L = $001c
	; source: libraries/wendy2/syslib.p8:253   &ubyte r14L = $001e
	; source: libraries/wendy2/syslib.p8:254   &ubyte r15L = $0020
	; source: libraries/wendy2/syslib.p8:256   &ubyte r0H  = $0003
	; source: libraries/wendy2/syslib.p8:257   &ubyte r1H  = $0005
	; source: libraries/wendy2/syslib.p8:258   &ubyte r2H  = $0007
	; source: libraries/wendy2/syslib.p8:259   &ubyte r3H  = $0009
	; source: libraries/wendy2/syslib.p8:260   &ubyte r4H  = $000b
	; source: libraries/wendy2/syslib.p8:261   &ubyte r5H  = $000d
	; source: libraries/wendy2/syslib.p8:262   &ubyte r6H  = $000f
	; source: libraries/wendy2/syslib.p8:263   &ubyte r7H  = $0011
	; source: libraries/wendy2/syslib.p8:264   &ubyte r8H  = $0013
	; source: libraries/wendy2/syslib.p8:265   &ubyte r9H  = $0015
	; source: libraries/wendy2/syslib.p8:266   &ubyte r10H = $0017
	; source: libraries/wendy2/syslib.p8:267   &ubyte r11H = $0019
	; source: libraries/wendy2/syslib.p8:268   &ubyte r12H = $001b
	; source: libraries/wendy2/syslib.p8:269   &ubyte r13H = $001d
	; source: libraries/wendy2/syslib.p8:270   &ubyte r14H = $001f
	; source: libraries/wendy2/syslib.p8:271   &ubyte r15H = $0021
	; source: libraries/wendy2/syslib.p8:274   &byte r0sL  = $0002
	; source: libraries/wendy2/syslib.p8:275   &byte r1sL  = $0004
	; source: libraries/wendy2/syslib.p8:276   &byte r2sL  = $0006
	; source: libraries/wendy2/syslib.p8:277   &byte r3sL  = $0008
	; source: libraries/wendy2/syslib.p8:278   &byte r4sL  = $000a
	; source: libraries/wendy2/syslib.p8:279   &byte r5sL  = $000c
	; source: libraries/wendy2/syslib.p8:280   &byte r6sL  = $000e
	; source: libraries/wendy2/syslib.p8:281   &byte r7sL  = $0010
	; source: libraries/wendy2/syslib.p8:282   &byte r8sL  = $0012
	; source: libraries/wendy2/syslib.p8:283   &byte r9sL  = $0014
	; source: libraries/wendy2/syslib.p8:284   &byte r10sL = $0016
	; source: libraries/wendy2/syslib.p8:285   &byte r11sL = $0018
	; source: libraries/wendy2/syslib.p8:286   &byte r12sL = $001a
	; source: libraries/wendy2/syslib.p8:287   &byte r13sL = $001c
	; source: libraries/wendy2/syslib.p8:288   &byte r14sL = $001e
	; source: libraries/wendy2/syslib.p8:289   &byte r15sL = $0020
	; source: libraries/wendy2/syslib.p8:291   &byte r0sH  = $0003
	; source: libraries/wendy2/syslib.p8:292   &byte r1sH  = $0005
	; source: libraries/wendy2/syslib.p8:293   &byte r2sH  = $0007
	; source: libraries/wendy2/syslib.p8:294   &byte r3sH  = $0009
	; source: libraries/wendy2/syslib.p8:295   &byte r4sH  = $000b
	; source: libraries/wendy2/syslib.p8:296   &byte r5sH  = $000d
	; source: libraries/wendy2/syslib.p8:297   &byte r6sH  = $000f
	; source: libraries/wendy2/syslib.p8:298   &byte r7sH  = $0011
	; source: libraries/wendy2/syslib.p8:299   &byte r8sH  = $0013
	; source: libraries/wendy2/syslib.p8:300   &byte r9sH  = $0015
	; source: libraries/wendy2/syslib.p8:301   &byte r10sH = $0017
	; source: libraries/wendy2/syslib.p8:302   &byte r11sH = $0019
	; source: libraries/wendy2/syslib.p8:303   &byte r12sH = $001b
	; source: libraries/wendy2/syslib.p8:304   &byte r13sH = $001d
	; source: libraries/wendy2/syslib.p8:305   &byte r14sH = $001f
	; source: libraries/wendy2/syslib.p8:306   &byte r15sH = $0021
	; source: libraries/wendy2/syslib.p8:309   &bool r0bL  = $0002
	; source: libraries/wendy2/syslib.p8:310   &bool r1bL  = $0004
	; source: libraries/wendy2/syslib.p8:311   &bool r2bL  = $0006
	; source: libraries/wendy2/syslib.p8:312   &bool r3bL  = $0008
	; source: libraries/wendy2/syslib.p8:313   &bool r4bL  = $000a
	; source: libraries/wendy2/syslib.p8:314   &bool r5bL  = $000c
	; source: libraries/wendy2/syslib.p8:315   &bool r6bL  = $000e
	; source: libraries/wendy2/syslib.p8:316   &bool r7bL  = $0010
	; source: libraries/wendy2/syslib.p8:317   &bool r8bL  = $0012
	; source: libraries/wendy2/syslib.p8:318   &bool r9bL  = $0014
	; source: libraries/wendy2/syslib.p8:319   &bool r10bL = $0016
	; source: libraries/wendy2/syslib.p8:320   &bool r11bL = $0018
	; source: libraries/wendy2/syslib.p8:321   &bool r12bL = $001a
	; source: libraries/wendy2/syslib.p8:322   &bool r13bL = $001c
	; source: libraries/wendy2/syslib.p8:323   &bool r14bL = $001e
	; source: libraries/wendy2/syslib.p8:324   &bool r15bL = $0020
	; source: libraries/wendy2/syslib.p8:326   &bool r0bH  = $0003
	; source: libraries/wendy2/syslib.p8:327   &bool r1bH  = $0005
	; source: libraries/wendy2/syslib.p8:328   &bool r2bH  = $0007
	; source: libraries/wendy2/syslib.p8:329   &bool r3bH  = $0009
	; source: libraries/wendy2/syslib.p8:330   &bool r4bH  = $000b
	; source: libraries/wendy2/syslib.p8:331   &bool r5bH  = $000d
	; source: libraries/wendy2/syslib.p8:332   &bool r6bH  = $000f
	; source: libraries/wendy2/syslib.p8:333   &bool r7bH  = $0011
	; source: libraries/wendy2/syslib.p8:334   &bool r8bH  = $0013
	; source: libraries/wendy2/syslib.p8:335   &bool r9bH  = $0015
	; source: libraries/wendy2/syslib.p8:336   &bool r10bH = $0017
	; source: libraries/wendy2/syslib.p8:337   &bool r11bH = $0019
	; source: libraries/wendy2/syslib.p8:338   &bool r12bH = $001b
	; source: libraries/wendy2/syslib.p8:339   &bool r13bH = $001d
	; source: libraries/wendy2/syslib.p8:340   &bool r14bH = $001f
	; source: libraries/wendy2/syslib.p8:341   &bool r15bH = $0021
	; source: libraries/wendy2/syslib.p8:191   cx16 {
	; source: libraries/wendy2/syslib.p8:344   asmsub save_virtual_registers() clobbers(A,Y) {

save_virtual_registers	.proc
	; source: libraries/wendy2/syslib.p8:345   %asm {{
            ldy  #31
    -       lda  cx16.r0,y
            sta  _cx16_vreg_storage,y
            dey
            bpl  -
            rts

            .section BSS
    _cx16_vreg_storage
            .word ?,?,?,?,?,?,?,?
            .word ?,?,?,?,?,?,?,?
            .send BSS
            ; !notreached!
	.pend
	; source: libraries/wendy2/syslib.p8:362   asmsub restore_virtual_registers() clobbers(A,Y) {

restore_virtual_registers	.proc
	; source: libraries/wendy2/syslib.p8:363   %asm {{
            ldy  #31
    -       lda  save_virtual_registers._cx16_vreg_storage,y
            sta  cx16.r0,y
            dey
            bpl  -
            rts
	.pend
	.pend

; ---- block: 'prog8_math' ----
prog8_math	.proc
	; source: library:/prog8lib/prog8_math.p8:1   prog8_math {


	; source: library:/prog8lib/prog8_math.p8:2   %option no_symbol_prefixing
	; source: library:/prog8lib/prog8_math.p8:4   %asminclude "library:math.asm"
; Internal Math library routines - always included by the compiler
; Generic machine independent 6502 code.
;
;  some more interesting routines can be found here:
;	http://6502org.wikidot.com/software-math
;	https://codebase64.net/doku.php?id=base:6502_6510_maths
;       https://github.com/TobyLobster/multiply_test
;       https://github.com/TobyLobster/sqrt_test


multiply_bytes	.proc
	; -- multiply 2 bytes A and Y, result as byte in A  (signed or unsigned)
	; https://github.com/TobyLobster/multiply_test/blob/main/tests/mult29.a

_multiplicand    = P8ZP_SCRATCH_B1
_multiplier      = P8ZP_SCRATCH_REG

    sty  _multiplicand
    lsr  a
    sta  _multiplier
    lda  #0
    ldx  #2
-
    bcc  +
    clc
    adc  _multiplicand
+
    ror  a
    ror  _multiplier
    bcc  +
    clc
    adc  _multiplicand
+
    ror  a
    ror  _multiplier

    bcc  +
    clc
    adc  _multiplicand
+
    ror  a
    ror  _multiplier
    bcc  +
    clc
    adc  _multiplicand
+
    ror  a
    ror  _multiplier
    dex
    bne  -
    ; tay       ; if you want 16 bits result in AY, enable this again
    lda  _multiplier
    rts
		.pend


multiply_words	.proc
	; -- multiply two 16-bit words into a 32-bit result  (UNSIGNED)
	;      input: A/Y = first 16-bit number, multiply_words.multiplier = second 16-bit number
	;      output: multiply_words.result, 4-bytes/32-bits product, LSB order (low-to-high)  low 16 bits also in AY.
	;      you can retrieve the upper 16 bits via math.mul16_last_upper()

	; NOTE FOR NEGATIVE VALUES:
	;      The routine also works for NEGATIVE (signed) word values, but ONLY the lower 16 bits of the result are correct then!
	;      Prog8 only uses those so that's not an issue, but math.mul16_last_upper() no longer gives the correct result here.

; mult62.a
; from: https://github.com/TobyLobster/multiply_test/blob/main/tests/mult62.a
; based on Dr Jefyll, http://forum.6502.org/viewtopic.php?f=9&t=689&start=0#p19958
; - adjusted to use fixed zero page addresses
; - removed 'decrement to avoid clc' as this is slower on average
; - rearranged memory use to remove final memory copy and give LSB first order to result
; - removed temp zp storage bytes
; - unrolled the outer loop
; - unrolled the two inner loops once
;
; 16 bit x 16 bit unsigned multiply, 32 bit result
; Average cycles: ~442 ?
; 93 bytes

_multiplicand    = P8ZP_SCRATCH_W2   ; 2 bytes
multiplier      = result

; 16 bit x 16 bit unsigned multiply, 32 bit result
;
; On Entry:
;   (multiplier, multiplier+1): two byte multiplier, four bytes needed for result
;   (multiplicand, multiplicand+1): two byte multiplicand
; On Exit:
;   (result, result+1, result+2, result+3): product

    sta  _multiplicand
    sty  _multiplicand+1

    lda  #0              ;
    sta  result+2        ; 16 bits of zero in A, result+2
                        ;  Note:    First 8 shifts are  A -> result+2 -> result
                        ;           Final 8 shifts are  A -> result+2 -> result+1

    ; --- 1st byte ---
    ldy  #4              ; count for inner loop
    lsr  result

    ; inner loop (8 times)
_inner_loop
    ; first time
    bcc +
    tax                 ; retain A
    lda  result+2
    clc
    adc  _multiplicand
    sta  result+2
    txa                 ; recall A
    adc  _multiplicand+1

+
    ror  a                ; shift
    ror  result+2
    ror  result

    ; second time
    bcc +
    tax                 ; retain A
    lda  result+2
    clc
    adc  _multiplicand
    sta  result+2
    txa                 ; recall A
    adc  _multiplicand+1

+
    ror  a                 ; shift
    ror  result+2
    ror  result

    dey
    bne  _inner_loop      ; go back for 1 more shift?

    ; --- 2nd byte ---
    ldy  #4              ; count for inner loop
    lsr  result+1

    ; inner loop (8 times)
_inner_loop2
    ; first time
    bcc  +
    tax                 ; retain A
    lda  result+2
    clc
    adc  _multiplicand
    sta  result+2
    txa                 ; recall A
    adc  _multiplicand+1

+
    ror  a                ; shift
    ror  result+2
    ror  result+1

    ; second time
    bcc  +
    tax                 ; retain A
    lda  result+2
    clc
    adc  _multiplicand
    sta  result+2
    txa                 ; recall A
    adc  _multiplicand+1

+
    ror  a                ; shift
    ror  result+2
    ror  result+1
    dey
    bne  _inner_loop2     ; go back for 1 more shift?

    sta  result+3        ; ms byte of hi-word of result

    lda  result
    ldy  result+1
    rts

		.section BSS
result		.byte  ?,?,?,?       ; routine could be faster if this were in Zeropage...
		.send BSS
		.pend


divmod_b_asm	.proc
	; signed byte division: make everything positive and fix sign afterwards
		sta  P8ZP_SCRATCH_B1
		tya
		eor  P8ZP_SCRATCH_B1
		php			; save sign
		lda  P8ZP_SCRATCH_B1
		bpl  +
		eor  #$ff
		sec
		adc  #0			; make it positive
+		pha
		tya
		bpl  +
		eor  #$ff
		sec
		adc  #0			; make it positive
		tay
+		pla
		jsr  divmod_ub_asm
		sta  _remainder
		plp
		bpl  +
		tya
		eor  #$ff
		sec
		adc  #0			; negate result
		tay
+		rts
		.section BSS
_remainder	.byte  ?
		.send BSS
		.pend


divmod_ub_asm	.proc
	; -- divide A by Y, result quotient in Y, remainder in A   (unsigned)
	;    division by zero will result in quotient = 255 and remainder = original number
		sty  P8ZP_SCRATCH_REG
		sta  P8ZP_SCRATCH_B1

		lda  #0
		ldx  #8
		asl  P8ZP_SCRATCH_B1
-		rol  a
		cmp  P8ZP_SCRATCH_REG
		bcc  +
		sbc  P8ZP_SCRATCH_REG
+		rol  P8ZP_SCRATCH_B1
		dex
		bne  -
		ldy  P8ZP_SCRATCH_B1
		rts
		.pend

remainder_ub_asm        .proc
		; -- divide A by Y, returns remainder in A   (unsigned)
		;    division by zero will result in just the original number.
		;    This routine specialcases 0,1,2 and otherwise is just a repeated subtraction.
		cpy  #0
		beq  _zero
		cpy  #1
		bne  +
		lda  #0
		rts
+		cpy  #2
		bne  +
		and  #1
		rts
+		sty  P8ZP_SCRATCH_REG
		sec
-		sbc  P8ZP_SCRATCH_REG
		bcs  -
		adc  P8ZP_SCRATCH_REG
_zero		rts
		.pend

divmod_w_asm	.proc
	; signed word division: make everything positive and fix sign afterwards
		sta  P8ZP_SCRATCH_W2
		sty  P8ZP_SCRATCH_W2+1
		lda  P8ZP_SCRATCH_W1+1
		eor  P8ZP_SCRATCH_W2+1
		php			; save sign
		lda  P8ZP_SCRATCH_W1+1
		bpl  +
		lda  #0
		sec
		sbc  P8ZP_SCRATCH_W1
		sta  P8ZP_SCRATCH_W1
		lda  #0
		sbc  P8ZP_SCRATCH_W1+1
		sta  P8ZP_SCRATCH_W1+1
+		lda  P8ZP_SCRATCH_W2+1
		bpl  +
		lda  #0
		sec
		sbc  P8ZP_SCRATCH_W2
		sta  P8ZP_SCRATCH_W2
		lda  #0
		sbc  P8ZP_SCRATCH_W2+1
		sta  P8ZP_SCRATCH_W2+1
+		tay
		lda  P8ZP_SCRATCH_W2
		jsr  divmod_uw_asm
		plp			; restore sign
		bpl  +
		sta  P8ZP_SCRATCH_W2
		sty  P8ZP_SCRATCH_W2+1
		lda  #0
		sec
		sbc  P8ZP_SCRATCH_W2
		pha
		lda  #0
		sbc  P8ZP_SCRATCH_W2+1
		tay
		pla
+		rts
		.pend

divmod_uw_asm	.proc
	; -- divide two unsigned words (16 bit each) into 16 bit results
	;    input:  P8ZP_SCRATCH_W1 in ZP: 16 bit number, A/Y: 16 bit divisor
	;    output: P8ZP_SCRATCH_W2 in ZP: 16 bit remainder, A/Y: 16 bit division result
	;    division by zero will result in quotient = 65535 and remainder = divident

dividend = P8ZP_SCRATCH_W1
remainder = P8ZP_SCRATCH_W2
result = dividend ;save memory by reusing divident to store the result

		sta  _divisor
		sty  _divisor+1
		lda  #0	        	;preset remainder to 0
		sta  remainder
		sta  remainder+1
		ldx  #16	        ;repeat for each bit: ...

-		asl  dividend		;dividend lb & hb*2, msb -> Carry
		rol  dividend+1
		rol  remainder		;remainder lb & hb * 2 + msb from carry
		rol  remainder+1
		lda  remainder
		sec
		sbc  _divisor		;substract divisor to see if it fits in
		tay	       		;lb result -> Y, for we may need it later
		lda  remainder+1
		sbc  _divisor+1
		bcc  +			;if carry=0 then divisor didn't fit in yet

		sta  remainder+1	;else save substraction result as new remainder,
		sty  remainder
		inc  result		;and INCrement result cause divisor fit in 1 times

+		dex
		bne  -

		lda  result
		ldy  result+1
		rts
		.section BSS
_divisor	.word ?
		.send BSS
		.pend

randword	.proc
	; -- 16 bit pseudo random number generator into AY
	;    default seed = $00c2 $1137.  NOTE:  uses self-modifying code so won't work in ROM (use randword_rom instead)
        ;    routine from https://codebase64.net/doku.php?id=6502_6510_maths:x_abc_random_number_generator_8_16_bit
		inc x1
		clc
x1=*+1
		lda #$00	;x1
c1=*+1
		eor #$c2	;c1
a1=*+1
		eor #$11	;a1
		sta a1
b1=*+1
		adc #$37	;b1
		sta b1
		lsr a
		eor a1
		adc c1
		sta c1
		ldy b1
		rts
		.pend

randword_rom	.proc
	; -- 16 bit pseudo random number generator into AY. Can run from ROM.
	;    NOTE: you have to set the initial seed using randseed_rom! (a good default seed = $00c2 $1137)
        ;    routine from https://codebase64.net/doku.php?id=6502_6510_maths:x_abc_random_number_generator_8_16_bit
		inc  _x1
		clc
		lda  _x1
		eor  _c1
		eor  _a1
		sta  _a1
		adc  _b1
		sta  _b1
		lsr  a
		eor  _a1
		adc  _c1
		sta  _c1
		ldy  _b1
		rts
		.section BSS
_x1      .byte  ?
_c1      .byte  ?
_a1      .byte  ?
_b1      .byte  ?
		.send BSS
		.pend

randbyte = randword             ; -- 8 bit pseudo random number generator into A (by just reusing randword) NOTE: can not run from ROM
randbyte_rom = randword_rom     ; -- 8 bit pseudo random number generator into A (by just reusing randword). Can run from ROM


; ----------- optimized multiplications (in-place A (byte) and ?? (word)) : ---------
mul_byte_3	.proc
		; A = A + A*2
		sta  P8ZP_SCRATCH_REG
		asl  a
		clc
		adc  P8ZP_SCRATCH_REG
		rts
		.pend

mul_word_3	.proc
		; AY = AY*2 + AY
		sta  P8ZP_SCRATCH_W1
		sty  P8ZP_SCRATCH_W1+1
		sta  P8ZP_SCRATCH_W2
		sty  P8ZP_SCRATCH_W2+1
		asl  a
		rol  P8ZP_SCRATCH_W1+1
		clc
		adc  P8ZP_SCRATCH_W2
		sta  P8ZP_SCRATCH_W1
		lda  P8ZP_SCRATCH_W1+1
		adc  P8ZP_SCRATCH_W2+1
		tay
		lda  P8ZP_SCRATCH_W1
		rts
		.pend


mul_byte_5	.proc
		; A = A*4 + A
		sta  P8ZP_SCRATCH_REG
		asl  a
		asl  a
		clc
		adc  P8ZP_SCRATCH_REG
		rts
		.pend

mul_word_5	.proc
		; AY = AY*4 + AY
		sta  P8ZP_SCRATCH_W1
		sty  P8ZP_SCRATCH_W1+1
		sta  P8ZP_SCRATCH_W2
		sty  P8ZP_SCRATCH_W2+1
		asl  a
		rol  P8ZP_SCRATCH_W1+1
		asl  a
		rol  P8ZP_SCRATCH_W1+1
		clc
		adc  P8ZP_SCRATCH_W2
		sta  P8ZP_SCRATCH_W1
		lda  P8ZP_SCRATCH_W1+1
		adc  P8ZP_SCRATCH_W2+1
		tay
		lda  P8ZP_SCRATCH_W1
		rts
		.pend


mul_byte_6	.proc
		; A = (A*2 + A)*2
		sta  P8ZP_SCRATCH_REG
		asl  a
                clc
                adc  P8ZP_SCRATCH_REG
		asl  a
		rts
		.pend

mul_word_6	.proc
		; AY = (AY*2 + AY)*2
		sta  P8ZP_SCRATCH_W1
		sty  P8ZP_SCRATCH_W1+1
		sta  P8ZP_SCRATCH_W2
		sty  P8ZP_SCRATCH_W2+1
		asl  a
		rol  P8ZP_SCRATCH_W1+1
		clc
		adc  P8ZP_SCRATCH_W2
		sta  P8ZP_SCRATCH_W1
		tay
		lda  P8ZP_SCRATCH_W1+1
		adc  P8ZP_SCRATCH_W2+1
		sta  P8ZP_SCRATCH_W1+1
		tya
		asl  a
		rol  P8ZP_SCRATCH_W1+1
		ldy  P8ZP_SCRATCH_W1+1
		rts
		.pend

mul_byte_7	.proc
		; A = A*8 - A
		sta  P8ZP_SCRATCH_REG
		asl  a
		asl  a
		asl  a
		sec
		sbc  P8ZP_SCRATCH_REG
		rts
		.pend

mul_word_7	.proc
		; AY = AY*8 - AY
		sta  P8ZP_SCRATCH_W1
		sty  P8ZP_SCRATCH_W1+1
		sta  P8ZP_SCRATCH_W2
		sty  P8ZP_SCRATCH_W2+1
		asl  a
		rol  P8ZP_SCRATCH_W1+1
		asl  a
		rol  P8ZP_SCRATCH_W1+1
		asl  a
		rol  P8ZP_SCRATCH_W1+1
		sec
		sbc  P8ZP_SCRATCH_W2
		sta  P8ZP_SCRATCH_W1
		lda  P8ZP_SCRATCH_W1+1
		sbc  P8ZP_SCRATCH_W2+1
		tay
		lda  P8ZP_SCRATCH_W1
		rts
		.pend

mul_byte_9	.proc
		; A = A*8 + A
		sta  P8ZP_SCRATCH_REG
		asl  a
		asl  a
		asl  a
		clc
		adc  P8ZP_SCRATCH_REG
		rts
		.pend

mul_word_9	.proc
		; AY = AY*8 + AY
		sta  P8ZP_SCRATCH_W1
		sty  P8ZP_SCRATCH_W1+1
		sta  P8ZP_SCRATCH_W2
		sty  P8ZP_SCRATCH_W2+1
		asl  a
		rol  P8ZP_SCRATCH_W1+1
		asl  a
		rol  P8ZP_SCRATCH_W1+1
		asl  a
		rol  P8ZP_SCRATCH_W1+1
		clc
		adc  P8ZP_SCRATCH_W2
		sta  P8ZP_SCRATCH_W1
		lda  P8ZP_SCRATCH_W1+1
		adc  P8ZP_SCRATCH_W2+1
		tay
		lda  P8ZP_SCRATCH_W1
		rts
		.pend

mul_byte_10	.proc
		; A=(A*4 + A)*2
		sta  P8ZP_SCRATCH_REG
		asl  a
		asl  a
		clc
		adc  P8ZP_SCRATCH_REG
		asl  a
		rts
		.pend

mul_word_10	.proc
		; AY=(AY*4 + AY)*2
		sta  P8ZP_SCRATCH_W1
		sty  P8ZP_SCRATCH_W1+1
		sta  P8ZP_SCRATCH_W2
		sty  P8ZP_SCRATCH_W2+1
		asl  a
		rol  P8ZP_SCRATCH_W1+1
		asl  a
		rol  P8ZP_SCRATCH_W1+1
		clc
		adc  P8ZP_SCRATCH_W2
		sta  P8ZP_SCRATCH_W1
		lda  P8ZP_SCRATCH_W1+1
		adc  P8ZP_SCRATCH_W2+1
		sta  P8ZP_SCRATCH_W1+1
		lda  P8ZP_SCRATCH_W1
		asl  a
		rol  P8ZP_SCRATCH_W1+1
		ldy  P8ZP_SCRATCH_W1+1
		rts
		.pend

mul_byte_11	.proc
		; A=(A*2 + A)*4 - A
		sta  P8ZP_SCRATCH_REG
		asl  a
		clc
		adc  P8ZP_SCRATCH_REG
		asl  a
		asl  a
		sec
		sbc  P8ZP_SCRATCH_REG
		rts
		.pend

; mul_word_11 is skipped (too much code)

mul_byte_12	.proc
		; A=(A*2 + A)*4
		sta  P8ZP_SCRATCH_REG
		asl  a
		clc
		adc  P8ZP_SCRATCH_REG
		asl  a
		asl  a
		rts
		.pend

mul_word_12	.proc
		; AY=(AY*2 + AY)*4
		sta  P8ZP_SCRATCH_W1
		sty  P8ZP_SCRATCH_W1+1
		sta  P8ZP_SCRATCH_W2
		sty  P8ZP_SCRATCH_W2+1
		asl  a
		rol  P8ZP_SCRATCH_W1+1
		clc
		adc  P8ZP_SCRATCH_W2
		sta  P8ZP_SCRATCH_W1
		lda  P8ZP_SCRATCH_W1+1
		adc  P8ZP_SCRATCH_W2+1
		sta  P8ZP_SCRATCH_W1+1
		lda  P8ZP_SCRATCH_W1
		asl  a
		rol  P8ZP_SCRATCH_W1+1
		asl  a
		rol  P8ZP_SCRATCH_W1+1
		ldy  P8ZP_SCRATCH_W1+1
		rts
		.pend

mul_byte_13	.proc
		; A=(A*2 + A)*4 + A
		sta  P8ZP_SCRATCH_REG
		asl  a
                clc
		adc  P8ZP_SCRATCH_REG
		asl  a
		asl  a
                clc
		adc  P8ZP_SCRATCH_REG
		rts
		.pend

; mul_word_13 is skipped (too much code)

mul_byte_14	.proc
		; A=(A*8 - A)*2
		sta  P8ZP_SCRATCH_REG
		asl  a
		asl  a
		asl  a
                sec
		sbc  P8ZP_SCRATCH_REG
                asl  a
		rts
		.pend

; mul_word_14 is skipped (too much code)

mul_byte_15	.proc
		; A=A*16 - A
		sta  P8ZP_SCRATCH_REG
		asl  a
		asl  a
		asl  a
		asl  a
		sec
		sbc  P8ZP_SCRATCH_REG
		rts
		.pend

mul_word_15	.proc
		; AY = AY * 16 - AY
		sta  P8ZP_SCRATCH_W1
		sty  P8ZP_SCRATCH_W1+1
		sta  P8ZP_SCRATCH_W2
		sty  P8ZP_SCRATCH_W2+1
		asl  a
		rol  P8ZP_SCRATCH_W1+1
		asl  a
		rol  P8ZP_SCRATCH_W1+1
		asl  a
		rol  P8ZP_SCRATCH_W1+1
		asl  a
		rol  P8ZP_SCRATCH_W1+1
		sec
		sbc  P8ZP_SCRATCH_W2
		sta  P8ZP_SCRATCH_W1
		lda  P8ZP_SCRATCH_W1+1
		sbc  P8ZP_SCRATCH_W2+1
		tay
		lda  P8ZP_SCRATCH_W1
		rts
		.pend

mul_byte_20	.proc
		; A=(A*4 + A)*4
		sta  P8ZP_SCRATCH_REG
		asl  a
		asl  a
		clc
		adc  P8ZP_SCRATCH_REG
		asl  a
		asl  a
		rts
		.pend

mul_word_20	.proc
		; AY = AY * 10 * 2
		jsr  mul_word_10
		sty  P8ZP_SCRATCH_REG
		asl  a
		rol  P8ZP_SCRATCH_REG
		ldy  P8ZP_SCRATCH_REG
		rts
		.pend

mul_byte_25	.proc
		; A=(A*2 + A)*8 + A
		sta  P8ZP_SCRATCH_REG
		asl  a
		clc
		adc  P8ZP_SCRATCH_REG
		asl  a
		asl  a
		asl  a
		clc
		adc  P8ZP_SCRATCH_REG
		rts
		.pend

mul_word_25	.proc
		; AY = (AY*2 + AY) *8 + AY
		sta  P8ZP_SCRATCH_W1
		sty  P8ZP_SCRATCH_W1+1
		sta  P8ZP_SCRATCH_W2
		sty  P8ZP_SCRATCH_W2+1
		asl  a
		rol  P8ZP_SCRATCH_W1+1
		clc
		adc  P8ZP_SCRATCH_W2
		sta  P8ZP_SCRATCH_W1
		lda  P8ZP_SCRATCH_W1+1
		adc  P8ZP_SCRATCH_W2+1
		sta  P8ZP_SCRATCH_W1+1
		lda  P8ZP_SCRATCH_W1
		asl  a
		rol  P8ZP_SCRATCH_W1+1
		asl  a
		rol  P8ZP_SCRATCH_W1+1
		asl  a
		rol  P8ZP_SCRATCH_W1+1
		clc
		adc  P8ZP_SCRATCH_W2
		sta  P8ZP_SCRATCH_W1
		lda  P8ZP_SCRATCH_W1+1
		adc  P8ZP_SCRATCH_W2+1
		tay
		lda  P8ZP_SCRATCH_W1
		rts
		.pend

mul_byte_40	.proc
		and  #7
		tay
		lda  _forties,y
		rts
_forties	.byte  0*40, 1*40, 2*40, 3*40, 4*40, 5*40, 6*40, 7*40 & 255
		.pend

mul_word_40	.proc
		; AY = (AY*4 + AY)*8
		sta  P8ZP_SCRATCH_W1
		sty  P8ZP_SCRATCH_W1+1
		sta  P8ZP_SCRATCH_W2
		sty  P8ZP_SCRATCH_W2+1
		asl  a
		rol  P8ZP_SCRATCH_W1+1
		asl  a
		rol  P8ZP_SCRATCH_W1+1
		clc
		adc  P8ZP_SCRATCH_W2
		sta  P8ZP_SCRATCH_W1
		lda  P8ZP_SCRATCH_W1+1
		adc  P8ZP_SCRATCH_W2+1
		asl  P8ZP_SCRATCH_W1
		rol  a
		asl  P8ZP_SCRATCH_W1
		rol  a
		asl  P8ZP_SCRATCH_W1
		rol  a
		tay
		lda  P8ZP_SCRATCH_W1
		rts
		.pend

mul_byte_50	.proc
		and  #7
		tay
		lda  _fifties, y
		rts
_fifties	.byte  0*50, 1*50, 2*50, 3*50, 4*50, 5*50, 6*50 & 255, 7*50 & 255
		.pend

mul_word_50	.proc
		; AY = AY * 25 * 2
		jsr  mul_word_25
		sty  P8ZP_SCRATCH_REG
		asl  a
		rol  P8ZP_SCRATCH_REG
		ldy  P8ZP_SCRATCH_REG
		rts
		.pend

mul_byte_80	.proc
		and  #3
		tay
		lda  _eighties, y
		rts
_eighties	.byte  0*80, 1*80, 2*80, 3*80
		.pend

mul_word_80	.proc
		; AY = AY * 40 * 2
		jsr  mul_word_40
		sty  P8ZP_SCRATCH_REG
		asl  a
		rol  P8ZP_SCRATCH_REG
		ldy  P8ZP_SCRATCH_REG
		rts
		.pend

mul_byte_100	.proc
		and  #3
		tay
		lda  _hundreds, y
		rts
_hundreds	.byte  0*100, 1*100, 2*100, 3*100 & 255
		.pend

mul_word_100	.proc
		; AY = AY * 25 * 4
		jsr  mul_word_25
		sty  P8ZP_SCRATCH_REG
		asl  a
		rol  P8ZP_SCRATCH_REG
		asl  a
		rol  P8ZP_SCRATCH_REG
		ldy  P8ZP_SCRATCH_REG
		rts
		.pend

mul_word_320	.proc
		; AY = A * 256 + A * 64	 (msb in Y doesn't matter)
		sta  P8ZP_SCRATCH_B1
		ldy  #0
		sty  P8ZP_SCRATCH_REG
		asl  a
		rol  P8ZP_SCRATCH_REG
		asl  a
		rol  P8ZP_SCRATCH_REG
		asl  a
		rol  P8ZP_SCRATCH_REG
		asl  a
		rol  P8ZP_SCRATCH_REG
		asl  a
		rol  P8ZP_SCRATCH_REG
		asl  a
		rol  P8ZP_SCRATCH_REG
		pha
		clc
		lda  P8ZP_SCRATCH_B1
		adc  P8ZP_SCRATCH_REG
		tay
		pla
		rts
		.pend

mul_word_640	.proc
		; AY = (A * 2 * 320) (msb in Y doesn't matter)
		asl  a
		jmp  mul_word_320
		.pend


; ----------- end optimized multiplications -----------


; support for bit shifting that is too large to be unrolled:

lsr_byte_A	.proc
		; -- lsr signed byte in A times the value in Y
		cpy  #0
		beq  +
		cmp  #0
		bpl  lsr_ubyte_A
-       	sec
		ror  a
		dey
		bne  -
+		rts
		.pend

lsr_ubyte_A	.proc
		; -- lsr unsigned byte in A times the value in Y
		cpy  #0
		beq  +
-		lsr  a
		dey
		bne  -
+		rts
		.pend

asl_byte_A      .proc
		; -- asl any byte in A times the value in Y
		cpy  #0
		beq  +
-		asl  a
		dey
		bne  -
+		rts
		.pend


lsr_word_AY     .proc
		; -- lsr signed word in AY times the value in X
		cpx  #0
		beq  +
		cpy  #0
		bpl  lsr_uword_AY
		sty  P8ZP_SCRATCH_B1
-		sec
		ror  P8ZP_SCRATCH_B1
		ror  a
		dex
		bne  -
		ldy  P8ZP_SCRATCH_B1
+		rts
		.pend

lsr_uword_AY    .proc
		; -- lsr unsigned word in AY times the value in X
		cpx  #0
		beq  +
		sty  P8ZP_SCRATCH_B1
-		lsr  P8ZP_SCRATCH_B1
		ror  a
		dex
		bne  -
		ldy  P8ZP_SCRATCH_B1
+		rts
		.pend

asl_word_AY     .proc
		; -- asl any word in AY times the value in X
		cpx  #0
		beq  +
		sty  P8ZP_SCRATCH_B1
-               asl  a
		rol  P8ZP_SCRATCH_B1
		dex
		bne  -
		ldy  P8ZP_SCRATCH_B1
+		rts
		.pend


square          .proc
; -- calculate square of signed word (actually -255..255) in AY, result in AY
; routine by Lee Davison, source: http://6502.org/source/integers/square.htm
; using this routine is a lot faster as doing a regular multiplication (for words)
;
; Calculates the 16 bit unsigned integer square of the signed 16 bit integer in
; Numberl/Numberh.  The result is always in the range 0 to 65025 and is held in
; Squarel/Squareh
;
; The maximum input range is only +/-255 and no checking is done to ensure that
; this is so.
;
; This routine is useful if you are trying to draw circles as for any circle
;
; x^2+y^2=r^2 where x and y are the co-ordinates of any point on the circle and
; r is the circle radius

numberl = P8ZP_SCRATCH_W1       ; number to square low byte
numberh = P8ZP_SCRATCH_W1+1     ; number to square high byte
squarel = P8ZP_SCRATCH_W2       ; square low byte
squareh = P8ZP_SCRATCH_W2+1     ; square high byte
tempsq = P8ZP_SCRATCH_B1        ; temp byte for intermediate result

	sta  numberl
	sty  numberh

        lda     #$00        ; clear a
        sta     squarel     ; clear square low byte
                            ; (no need to clear the high byte, it gets shifted out)
        lda	numberl     ; get number low byte
	ldx	numberh     ; get number high  byte
	bpl	_nonneg      ; if +ve don't negate it
                            ; else do a two's complement
	eor	#$ff        ; invert
        sec	            ; +1
	adc	#$00        ; and add it

_nonneg:
	sta	tempsq      ; save abs(number)
	ldx	#$08        ; set bit count

_nextr2bit:
	asl	squarel     ; low byte *2
	rol	squareh     ; high byte *2+carry from low
	asl	a           ; shift number byte
	bcc	_nosqadd     ; don't do add if c = 0
	tay                 ; save a
	clc                 ; clear carry for add
	lda	tempsq      ; get number
	adc	squarel     ; add number^2 low byte
	sta	squarel     ; save number^2 low byte
	lda	#$00        ; clear a
	adc	squareh     ; add number^2 high byte
	sta	squareh     ; save number^2 high byte
	tya                 ; get a back

_nosqadd:
	dex                 ; decrement bit count
	bne	_nextr2bit   ; go do next bit

	lda  squarel
	ldy  squareh
	rts

		.pend
	.pend

; ---- block: 'prog8_lib' ----
prog8_lib	.proc
	; source: library:/prog8lib/prog8_lib.p8:3   prog8_lib {


	; source: library:/prog8lib/prog8_lib.p8:4   %option no_symbol_prefixing, ignore_unused
	; source: library:/prog8lib/prog8_lib.p8:6   %asminclude "library:prog8_lib.asm"
; Internal library routines - always included by the compiler
; Generic machine independent 6502 code.

		.section BSS_NOCLEAR
orig_stackpointer	.byte  ?	; stores the Stack pointer register at program start
		.send BSS_NOCLEAR

program_startup_clear_bss    .proc
	; this is always ran first thing from the start routine to clear out the BSS area
	.if  prog8_bss_section_size>0
		; reset all variables in BSS section to zero
		lda  #<prog8_bss_section_start
		ldy  #>prog8_bss_section_start
		sta  P8ZP_SCRATCH_W1
		sty  P8ZP_SCRATCH_W1+1
		ldx  #<prog8_bss_section_size
		ldy  #>prog8_bss_section_size
		lda  #0
		jsr  prog8_lib.memset
	.endif
		rts
		.pend



read_byte_from_address_in_AY_into_A	.proc
		sta  P8ZP_SCRATCH_W2
		sty  P8ZP_SCRATCH_W2+1
		ldy  #0
		lda  (P8ZP_SCRATCH_W2),y
		rts
		.pend

read_byte_from_address_in_AY_into_A_65c02	.proc
		sta  P8ZP_SCRATCH_W2
		sty  P8ZP_SCRATCH_W2+1
		lda  (P8ZP_SCRATCH_W2)
		rts
		.pend


write_byte_X_to_address_in_AY	.proc
		sta  P8ZP_SCRATCH_W2
		sty  P8ZP_SCRATCH_W2+1
		ldy  #0
		txa
		sta  (P8ZP_SCRATCH_W2),y
		rts
		.pend

write_byte_X_to_address_in_AY_65c02	.proc
		sta  P8ZP_SCRATCH_W2
		sty  P8ZP_SCRATCH_W2+1
		txa
		sta  (P8ZP_SCRATCH_W2)
		rts
		.pend


reg_less_uw	.proc
		;  AY < P8ZP_SCRATCH_W2?
		cpy  P8ZP_SCRATCH_W2+1
		bcc  _true
		bne  _false
		cmp  P8ZP_SCRATCH_W2
		bcc  _true
_false		lda  #0
		rts
_true		lda  #1
		rts
		.pend

reg_less_w	.proc
		; -- AY < P8ZP_SCRATCH_W2?
		cmp  P8ZP_SCRATCH_W2
		tya
		sbc  P8ZP_SCRATCH_W2+1
		bvc  +
		eor  #$80
+		bmi  _true
		lda  #0
		rts
_true		lda  #1
		rts
		.pend

reg_lesseq_uw	.proc
		; AY <= P8ZP_SCRATCH_W2?
		cpy  P8ZP_SCRATCH_W2+1
		beq  +
		bcc  _true
		lda  #0
		rts
+		cmp  P8ZP_SCRATCH_W2
		bcc  _true
		beq  _true
		lda  #0
		rts
_true		lda  #1
		rts
		.pend

reg_lesseq_w	.proc
		; -- P8ZP_SCRATCH_W2 <= AY ?   (note: order different from other routines)
		cmp  P8ZP_SCRATCH_W2
		tya
		sbc  P8ZP_SCRATCH_W2+1
		bvc  +
		eor  #$80
+		bpl  +
		lda  #0
		rts
+		lda  #1
		rts
		.pend


memcopy16_up	.proc
	; -- copy memory UP from (P8ZP_SCRATCH_W1) to (P8ZP_SCRATCH_W2) of length X/Y (16-bit, X=lo, Y=hi)
	;    clobbers register A,X,Y
		source = P8ZP_SCRATCH_W1
		dest = P8ZP_SCRATCH_W2
		length = P8ZP_SCRATCH_B1   ; (and SCRATCH_ZPREG)

		stx  length
		sty  length+1

		ldx  length             ; move low byte of length into X
		bne  +                  ; jump to start if X > 0
		dec  length             ; subtract 1 from length
+		ldy  #0                 ; set Y to 0
-		lda  (source),y         ; set A to whatever (source) points to offset by Y
		sta  (dest),y           ; move A to location pointed to by (dest) offset by Y
		iny                     ; increment Y
		bne  +                  ; if Y<>0 then (rolled over) then still moving bytes
		inc  source+1           ; increment hi byte of source
		inc  dest+1             ; increment hi byte of dest
+		dex                     ; decrement X (lo byte counter)
		bne  -                  ; if X<>0 then move another byte
		dec  length             ; we've moved 255 bytes, dec length
		bpl  -                  ; if length is still positive go back and move more
		rts                     ; done
		.pend


memset          .proc
	; -- fill memory from (P8ZP_SCRATCH_W1), length XY, with value in A.
	;    clobbers X, Y
		stx  P8ZP_SCRATCH_B1
		sty  P8ZP_SCRATCH_REG
		ldy  #0
		ldx  P8ZP_SCRATCH_REG
		beq  _lastpage

_fullpage	sta  (P8ZP_SCRATCH_W1),y
		iny
		bne  _fullpage
		inc  P8ZP_SCRATCH_W1+1          ; next page
		dex
		bne  _fullpage

_lastpage	ldy  P8ZP_SCRATCH_B1
		beq  +
-         	dey
		sta  (P8ZP_SCRATCH_W1),y
		bne  -

+           	rts
		.pend


memsetw		.proc
	; -- fill memory from (P8ZP_SCRATCH_W1) number of words in P8ZP_SCRATCH_W2, with word value in AY.
	;    clobbers A, X, Y
		sta  _val
		sty  _val+1
		ldx  P8ZP_SCRATCH_W1
		stx  P8ZP_SCRATCH_B1
		ldx  P8ZP_SCRATCH_W1+1
		inx
		stx  P8ZP_SCRATCH_REG                ; second page

		ldy  #0
		ldx  P8ZP_SCRATCH_W2+1
		beq  _lastpage

_fullpage
		lda  _val
		sta  (P8ZP_SCRATCH_W1),y        ; first page
		sta  (P8ZP_SCRATCH_B1),y            ; second page
		iny
		lda  _val+1
		sta  (P8ZP_SCRATCH_W1),y        ; first page
		sta  (P8ZP_SCRATCH_B1),y            ; second page
		iny
		bne  _fullpage
		inc  P8ZP_SCRATCH_W1+1          ; next page pair
		inc  P8ZP_SCRATCH_W1+1          ; next page pair
		inc  P8ZP_SCRATCH_B1+1              ; next page pair
		inc  P8ZP_SCRATCH_B1+1              ; next page pair
		dex
		bne  _fullpage

_lastpage	ldx  P8ZP_SCRATCH_W2
		beq  _done

		ldy  #0
-
		lda  _val
		sta  (P8ZP_SCRATCH_W1), y
		inc  P8ZP_SCRATCH_W1
		bne  +
		inc  P8ZP_SCRATCH_W1+1
+		lda  _val+1
		sta  (P8ZP_SCRATCH_W1), y
		inc  P8ZP_SCRATCH_W1
		bne  +
		inc  P8ZP_SCRATCH_W1+1
+               dex
		bne  -
_done		rts
		.section BSS
_val	.word ?
		.send BSS
		.pend



ror2_mem_ub	.proc
		; -- in-place 8-bit ror of byte at memory location in AY
		sta  P8ZP_SCRATCH_W1
		sty  P8ZP_SCRATCH_W1+1
		ldy  #0
		lda  (P8ZP_SCRATCH_W1),y
		lsr  a
		bcc  +
		ora  #$80
+		sta  (P8ZP_SCRATCH_W1),y
		rts
		.pend

rol2_mem_ub	.proc
		; -- in-place 8-bit rol of byte at memory location in AY
		sta  P8ZP_SCRATCH_W1
		sty  P8ZP_SCRATCH_W1+1
		ldy  #0
		lda  (P8ZP_SCRATCH_W1),y
		cmp  #$80
		rol  a
		sta  (P8ZP_SCRATCH_W1),y
		rts
		.pend


strcpy		.proc
		; copy a string (must be 0-terminated) from A/Y to (P8ZP_SCRATCH_W1)
		; it is assumed the target string is large enough.
		; returns the length of the string that was copied in Y.
		sta  P8ZP_SCRATCH_W2
		sty  P8ZP_SCRATCH_W2+1
		ldy  #$ff
-		iny
		lda  (P8ZP_SCRATCH_W2),y
		sta  (P8ZP_SCRATCH_W1),y
		bne  -
		rts
		.pend

strncpy		.proc
		; copy a string (must be 0-terminated) from A/Y to (P8ZP_SCRATCH_W1)
		; with maximum length to copy in X.
		; returns the length of the string that was copied in Y.
		sta  P8ZP_SCRATCH_W2
		sty  P8ZP_SCRATCH_W2+1
		ldy  #$ff
-		iny
		lda  (P8ZP_SCRATCH_W2),y
		sta  (P8ZP_SCRATCH_W1),y
		beq  +
		dex
		bne  -
		iny
		lda  #0
		sta  (P8ZP_SCRATCH_W1),y
+		rts
		.pend

strcmp_expression	.proc
		; -- compare strings, result in A
		lda  _arg_s2
		ldy  _arg_s2+1
		sta  P8ZP_SCRATCH_W2
		sty  P8ZP_SCRATCH_W2+1
		lda  _arg_s1
		ldy  _arg_s1+1
		jmp  strcmp_mem
		.section BSS
_arg_s1		.word  ?
_arg_s2		.word  ?
		.send BSS
		.pend

strcmp_mem	.proc
		; --   compares strings in s1 (AY) and s2 (P8ZP_SCRATCH_W2).
		;      Returns -1,0,1 in A, depending on the ordering. Clobbers Y.
		sta  P8ZP_SCRATCH_W1
		sty  P8ZP_SCRATCH_W1+1
		ldy  #0
_loop           lda  (P8ZP_SCRATCH_W1),y
		beq  _c1_zero
		cmp  (P8ZP_SCRATCH_W2),y
		beq  _equal
		bmi  _less
		lda  #1
		rts
_less           lda  #-1
		rts
_equal          iny
		bne  _loop
_c1_zero        lda  (P8ZP_SCRATCH_W2),y
		beq  +
		lda  #-1
+		rts
		.pend


strlen          .proc
        ; -- returns the number of bytes in the string in AY, in Y. Clobbers A.
		sta  P8ZP_SCRATCH_W1
		sty  P8ZP_SCRATCH_W1+1
		ldy  #0
-		lda  (P8ZP_SCRATCH_W1),y
		beq  +
		iny
		bne  -
+		rts
		.pend


containment_bytearray	.proc
	; -- check if a value exists in a byte array.
	;    parameters: P8ZP_SCRATCH_W1: address of the byte array, A = byte to check, Y = length of array (>=1).
	;    returns boolean 0/1 in A.
		dey
-		cmp  (P8ZP_SCRATCH_W1),y
		beq  +
		dey
		cpy  #255
		bne  -
		lda  #0
		rts
+		lda  #1
		rts
		.pend

containment_linearwordarray	.proc
	; -- check if a value exists in a linear word array.
	;    parameters: P8ZP_SCRATCH_W1: value to check, P8ZP_SCRATCH_W2: address of the word array, Y = number of elements in the array (>=1).
	;    returns boolean 0/1 in A.
		dey
		tya
		asl  a
		tay
-		lda  P8ZP_SCRATCH_W1
		cmp  (P8ZP_SCRATCH_W2),y
		bne  +
		lda  P8ZP_SCRATCH_W1+1
		iny
		cmp  (P8ZP_SCRATCH_W2),y
		beq  _found
		dey
+		dey
		dey
		cpy  #254
		bne  -
		lda  #0
		rts
_found		lda  #1
		rts
		.pend

containment_splitwordarray	.proc
	; -- check if a value exists in a split lsb/msb word array. (Assuming lsb array comes first, immediately followed by msb array)
	;    parameters: P8ZP_SCRATCH_W1: value to check, P8ZP_SCRATCH_W2: start address of the lsb word array, Y = number of elements in the array (>=1).
	;    returns boolean 0/1 in A.

	; store the needle value in SCRATCH_B1(lsb) and SCRATCH_REG(msb)
		lda  P8ZP_SCRATCH_W1
		sta  P8ZP_SCRATCH_B1
		lda  P8ZP_SCRATCH_W1+1
		sta  P8ZP_SCRATCH_REG

	; calculate where the msb array starts and put this in P8ZP_SCRATCH_W1  (_W2 is the start of the lsb array)
		tya
		clc
		adc  P8ZP_SCRATCH_W2
		sta  P8ZP_SCRATCH_W1
		lda  P8ZP_SCRATCH_W2+1
		adc  #0
		sta  P8ZP_SCRATCH_W1+1

	; search needle
		dey
-               lda  P8ZP_SCRATCH_REG
		cmp  (P8ZP_SCRATCH_W1),y
		bne  +
		lda  P8ZP_SCRATCH_B1
		cmp  (P8ZP_SCRATCH_W2),y
		beq  _found
+               dey
		cpy  #255
		bne  -
		lda  #0
		rts
_found          lda  #1
		rts
	.pend


memcopy_small   .proc
		; copy up to a single page (256 bytes) of memory.
		; note: only works for NON-OVERLAPPING memory regions!
		; P8ZP_SCRATCH_W1 = from address
		; P8ZP_SCRATCH_W2 = destination address
		; Y = number of bytes to copy  (where 0 means 256)
		cpy  #0
		beq  _fullpage
		dey
		beq  _lastbyte
_loop           lda  (P8ZP_SCRATCH_W1),y
                sta  (P8ZP_SCRATCH_W2),y
                dey
                bne  _loop
_lastbyte       lda  (P8ZP_SCRATCH_W1),y
                sta  (P8ZP_SCRATCH_W2),y
                rts
_fullpage       lda  (P8ZP_SCRATCH_W1),y
                sta  (P8ZP_SCRATCH_W2),y
                dey
                bne  _fullpage
                rts
		.pend


long_not_equals     .proc
		; checks if the 32 bits long value pointed to by AY is NOT equal to the one pointed to by P8ZP_SCRATCH_W1
		; returns A=1 if NOT equals otherwise A=0
		sta  P8ZP_SCRATCH_W2
		sty  P8ZP_SCRATCH_W2+1
		ldy  #3
-		lda  (P8ZP_SCRATCH_W1),y
		cmp  (P8ZP_SCRATCH_W2),y
		bne  _notequal
		dey
		bpl  -
		lda  #0
		rts
_notequal       lda  #1
		rts
		.pend


long_add_inplace        .proc
		; long pointed to by AY += long pointed to by P8ZP_SCRATCH_W1
		sta  P8ZP_SCRATCH_W2
		sty  P8ZP_SCRATCH_W2+1
		clc
		ldy  #0
		lda  (P8ZP_SCRATCH_W2),y
		adc  (P8ZP_SCRATCH_W1),y
		sta  (P8ZP_SCRATCH_W2),y
		iny
		lda  (P8ZP_SCRATCH_W2),y
		adc  (P8ZP_SCRATCH_W1),y
		sta  (P8ZP_SCRATCH_W2),y
		iny
		lda  (P8ZP_SCRATCH_W2),y
		adc  (P8ZP_SCRATCH_W1),y
		sta  (P8ZP_SCRATCH_W2),y
		iny
		lda  (P8ZP_SCRATCH_W2),y
		adc  (P8ZP_SCRATCH_W1),y
		sta  (P8ZP_SCRATCH_W2),y
		rts
		.pend

long_sub_inplace    .proc
		; long pointed to by AY -= long pointed to by P8ZP_SCRATCH_W1
		sta  P8ZP_SCRATCH_W2
		sty  P8ZP_SCRATCH_W2+1
		ldy  #0
		sec
		lda  (P8ZP_SCRATCH_W2),y
		sbc  (P8ZP_SCRATCH_W1),y
		sta  (P8ZP_SCRATCH_W2),y
		iny
		lda  (P8ZP_SCRATCH_W2),y
		sbc  (P8ZP_SCRATCH_W1),y
		sta  (P8ZP_SCRATCH_W2),y
		iny
		lda  (P8ZP_SCRATCH_W2),y
		sbc  (P8ZP_SCRATCH_W1),y
		sta  (P8ZP_SCRATCH_W2),y
		iny
		lda  (P8ZP_SCRATCH_W2),y
		sbc  (P8ZP_SCRATCH_W1),y
		sta  (P8ZP_SCRATCH_W2),y
		rts
		.pend

long_or_inplace       .proc
		; long pointed to by AY OR= long pointed to by P8ZP_SCRATCH_W1
		sta  P8ZP_SCRATCH_W2
		sty  P8ZP_SCRATCH_W2+1
		ldy  #0
		lda  (P8ZP_SCRATCH_W2),y
		ora  (P8ZP_SCRATCH_W1),y
		sta  (P8ZP_SCRATCH_W2),y
		iny
		lda  (P8ZP_SCRATCH_W2),y
		ora  (P8ZP_SCRATCH_W1),y
		sta  (P8ZP_SCRATCH_W2),y
		iny
		lda  (P8ZP_SCRATCH_W2),y
		ora  (P8ZP_SCRATCH_W1),y
		sta  (P8ZP_SCRATCH_W2),y
		iny
		lda  (P8ZP_SCRATCH_W2),y
		ora  (P8ZP_SCRATCH_W1),y
		sta  (P8ZP_SCRATCH_W2),y
		rts
		.pend

long_and_inplace       .proc
		; long pointed to by AY AND= long pointed to by P8ZP_SCRATCH_W1
		sta  P8ZP_SCRATCH_W2
		sty  P8ZP_SCRATCH_W2+1
		ldy  #0
		lda  (P8ZP_SCRATCH_W2),y
		and  (P8ZP_SCRATCH_W1),y
		sta  (P8ZP_SCRATCH_W2),y
		iny
		lda  (P8ZP_SCRATCH_W2),y
		and  (P8ZP_SCRATCH_W1),y
		sta  (P8ZP_SCRATCH_W2),y
		iny
		lda  (P8ZP_SCRATCH_W2),y
		and  (P8ZP_SCRATCH_W1),y
		sta  (P8ZP_SCRATCH_W2),y
		iny
		lda  (P8ZP_SCRATCH_W2),y
		and  (P8ZP_SCRATCH_W1),y
		sta  (P8ZP_SCRATCH_W2),y
		rts
		.pend

long_xor_inplace       .proc
		; long pointed to by AY XOR= long pointed to by P8ZP_SCRATCH_W1
		sta  P8ZP_SCRATCH_W2
		sty  P8ZP_SCRATCH_W2+1
		ldy  #0
		lda  (P8ZP_SCRATCH_W2),y
		eor  (P8ZP_SCRATCH_W1),y
		sta  (P8ZP_SCRATCH_W2),y
		iny
		lda  (P8ZP_SCRATCH_W2),y
		eor  (P8ZP_SCRATCH_W1),y
		sta  (P8ZP_SCRATCH_W2),y
		iny
		lda  (P8ZP_SCRATCH_W2),y
		eor  (P8ZP_SCRATCH_W1),y
		sta  (P8ZP_SCRATCH_W2),y
		iny
		lda  (P8ZP_SCRATCH_W2),y
		eor  (P8ZP_SCRATCH_W1),y
		sta  (P8ZP_SCRATCH_W2),y
		rts
		.pend

long_negate_inplace	.proc
		; negate a signed long pointed to by AY in place
		; Uses two's complement: flip all bits then add 1
		sta P8ZP_SCRATCH_PTR
		sty P8ZP_SCRATCH_PTR+1

		ldy #$00
		lda (P8ZP_SCRATCH_PTR),y
		eor #$FF
		sta (P8ZP_SCRATCH_PTR),y
		iny

		lda (P8ZP_SCRATCH_PTR),y
		eor #$FF
		sta (P8ZP_SCRATCH_PTR),y
		iny

		lda (P8ZP_SCRATCH_PTR),y
		eor #$FF
		sta (P8ZP_SCRATCH_PTR),y
		iny

		lda (P8ZP_SCRATCH_PTR),y
		eor #$FF
		sta (P8ZP_SCRATCH_PTR),y

		; Add 1 to get two's complement (incrementing the 32-bit value)
		clc
		lda #$01
		ldy #$00
		adc (P8ZP_SCRATCH_PTR),y
		sta (P8ZP_SCRATCH_PTR),y
		bcc +
		iny
		lda #$00
		adc (P8ZP_SCRATCH_PTR),y
		sta (P8ZP_SCRATCH_PTR),y
		bcc +
		iny
		lda #$00
		adc (P8ZP_SCRATCH_PTR),y
		sta (P8ZP_SCRATCH_PTR),y
		bcc +
		iny
		lda #$00
		adc (P8ZP_SCRATCH_PTR),y
		sta (P8ZP_SCRATCH_PTR),y
+		rts
		.pend

long_shiftleftX_inplace         .proc
		; bit shift left X bits the long value pointed to by AY
		cpx  #0
		beq  _end
		sta  P8ZP_SCRATCH_W1
		sty  P8ZP_SCRATCH_W1+1
-		ldy  #0
		lda  (P8ZP_SCRATCH_W1),y
		asl  a
		sta  (P8ZP_SCRATCH_W1),y
		iny
		lda  (P8ZP_SCRATCH_W1),y
		rol  a
		sta  (P8ZP_SCRATCH_W1),y
		iny
		lda  (P8ZP_SCRATCH_W1),y
		rol  a
		sta  (P8ZP_SCRATCH_W1),y
		iny
		lda  (P8ZP_SCRATCH_W1),y
		rol  a
		sta  (P8ZP_SCRATCH_W1),y
		dex
		bne  -
_end		rts
		.pend

long_shiftrightX_inplace        .proc
		; bit shift right X bits the long value pointed to by AY
		cpx  #0
		beq  _end
		sta  P8ZP_SCRATCH_W1
		sty  P8ZP_SCRATCH_W1+1
-		ldy  #3
		lda  (P8ZP_SCRATCH_W1),y
		asl  a  ; save sign bit
		lda  (P8ZP_SCRATCH_W1),y
		ror  a
		sta  (P8ZP_SCRATCH_W1),y
		dey
		lda  (P8ZP_SCRATCH_W1),y
		ror  a
		sta  (P8ZP_SCRATCH_W1),y
		dey
		lda  (P8ZP_SCRATCH_W1),y
		ror  a
		sta  (P8ZP_SCRATCH_W1),y
		dey
		lda  (P8ZP_SCRATCH_W1),y
		ror  a
		sta  (P8ZP_SCRATCH_W1),y
		dex
		bne  -
_end		rts
		.pend

compare_long_gt_0        .proc
		; pointer to 32 bits signed long in P8ZP_SCRATCH_W1, carry Set: value>0, carry clear: value <=0
		ldy  #3
		lda  (P8ZP_SCRATCH_W1),y
		bmi  _fail
		dey
		ora  (P8ZP_SCRATCH_W1),y
		dey
		ora  (P8ZP_SCRATCH_W1),y
		dey
		ora  (P8ZP_SCRATCH_W1),y
		beq  _fail
		sec
		rts
_fail		clc
		rts
		.pend

compare_long_le_0        .proc
		; pointer to 32 bits signed long in P8ZP_SCRATCH_W1, carry Set: value<=0, carry clear: value >0
		ldy  #3
		lda  (P8ZP_SCRATCH_W1),y
		bmi  _success
		dey
		ora  (P8ZP_SCRATCH_W1),y
		dey
		ora  (P8ZP_SCRATCH_W1),y
		dey
		ora  (P8ZP_SCRATCH_W1),y
		beq  _success
		clc
		rts
_success	sec
		rts
		.pend


copyfrompointer1topointer2_word         .proc
		; copy word pointed to by P8ZP_SCRATCH_W1 to word pointed to by AY
		sta  P8ZP_SCRATCH_W2
		sty  P8ZP_SCRATCH_W2+1
		ldy  #0
		lda  (P8ZP_SCRATCH_W1),y
		sta  (P8ZP_SCRATCH_W2),y
		iny
		lda  (P8ZP_SCRATCH_W1),y
		sta  (P8ZP_SCRATCH_W2),y
		rts
		.pend

copyfrompointer1topointer2_long         .proc
		; copy long pointed to by P8ZP_SCRATCH_W1 to long pointed to by AY
		sta  P8ZP_SCRATCH_W2
		sty  P8ZP_SCRATCH_W2+1
		ldy  #0
		lda  (P8ZP_SCRATCH_W1),y
		sta  (P8ZP_SCRATCH_W2),y
		iny
		lda  (P8ZP_SCRATCH_W1),y
		sta  (P8ZP_SCRATCH_W2),y
		iny
		lda  (P8ZP_SCRATCH_W1),y
		sta  (P8ZP_SCRATCH_W2),y
		iny
		lda  (P8ZP_SCRATCH_W1),y
		sta  (P8ZP_SCRATCH_W2),y
		rts
		.pend


swap_words      .proc
	; -- swap word values pointed to by P8ZP_SCRATCH_W1 and AY
	sta  P8ZP_SCRATCH_W2
	sty  P8ZP_SCRATCH_W2+1
	ldy  #0
	lda  (P8ZP_SCRATCH_W1),y
	pha
	iny
	lda  (P8ZP_SCRATCH_W1),y
	tax
	lda  (P8ZP_SCRATCH_W2),y
	sta  (P8ZP_SCRATCH_W1),y
	dey
	lda  (P8ZP_SCRATCH_W2),y
	sta  (P8ZP_SCRATCH_W1),y
	pla
	sta  (P8ZP_SCRATCH_W2),y
	iny
	txa
	sta  (P8ZP_SCRATCH_W2),y
	rts
	.pend

swap_longs      .proc
	; -- swap long values pointed to by P8ZP_SCRATCH_W1 and AY. Clobbers R14 and R15 (temporary swap var)

	sta  P8ZP_SCRATCH_W2
	sty  P8ZP_SCRATCH_W2+1
	ldy  #3
-	lda  (P8ZP_SCRATCH_W1),y
	sta  cx16.r14r15sl,y
	lda  (P8ZP_SCRATCH_W2),y
	sta  (P8ZP_SCRATCH_W1),y
	dey
	bpl  -
	ldy  #3
-	lda  cx16.r14r15sl,y
	sta  (P8ZP_SCRATCH_W2),y
	dey
	bpl  -
	rts
	.pend
	; source: library:/prog8lib/prog8_lib.p8:7   %asminclude "library:prog8_funcs.asm"
; ---- builtin functions

abs_b_into_A	.proc
	; -- A = abs(A)
		cmp  #0
		bmi  +
		rts
+		eor  #$ff
		clc
		adc  #1
		rts
		.pend

abs_w_into_AY	.proc
	; -- AY = abs(AY)
		cpy  #0
		bmi  +
		rts
+		eor  #$ff
		pha
		tya
		eor  #$ff
		tay
		pla
		clc
		adc  #1
		bcc  +
		iny
+		rts
		.pend

abs_l_into_R14R15	.proc
	; -- R14:R15 = abs(R14:R15)
    lda  cx16.r15H
    bmi  +   ; Negative if high bit of highest byte is set
    rts
+
    ; Invert all four bytes
    lda  cx16.r14L
    eor  #$FF
    sta  cx16.r14L
    lda  cx16.r14H
    eor  #$FF
    sta  cx16.r14H
    lda  cx16.r15L
    eor  #$FF
    sta  cx16.r15L
    lda  cx16.r15H
    eor  #$FF
    sta  cx16.r15H
    ; Add 1 to whole 32-bit value
    inc  cx16.r14L
    bne  +
    inc  cx16.r14H
    bne  +
    inc  cx16.r15L
    bne  +
    inc  cx16.r15H
+   rts
		.pend

func_sign_b_into_A	.proc
		cmp  #0
		beq  _zero
		bmi  _neg
		lda  #1
_zero		rts
_neg		lda  #-1
		rts
		.pend

func_sign_ub_into_A	.proc
		cmp  #0
		bne  _pos
		rts
_pos		lda  #1
		rts
		.pend

func_sign_uw_into_A	.proc
		cpy  #0
		beq  _possibly_zero
_pos		lda  #1
		rts
_possibly_zero	cmp  #0
		bne  _pos
		rts
		.pend

func_sign_w_into_A	.proc
		cpy  #0
		bmi  _negative
		bne  _positive
		cmp  #0
		beq  _zero
_positive	lda  #1
_zero		rts
_negative	lda  #-1
		rts
		.pend

func_sign_l_r14r15_into_A      .proc
    lda  cx16.r14+3              ; msb
    bmi  _negative
    bne  _positive
    lda  cx16.r14+2
    bne  _positive
    lda  cx16.r14+1
    bne  _positive
    lda  cx16.r14
    beq  _zero
    lda  #1
_zero
    rts
_negative
    lda  #-1
    rts
_positive
    lda  #1
    rts

.pend



func_sqrt16_into_A	.proc
		; integer square root
		; http://6502org.wikidot.com/software-math-sqrt
		; https://github.com/TobyLobster/sqrt_test/blob/main/sqrt/sqrt7.a
		; Tweaked by TobyLobster and 0xC0DE to be smaller and faster
_numl = P8ZP_SCRATCH_W1
_numh = P8ZP_SCRATCH_W1+1
_loop_counter = P8ZP_SCRATCH_REG
_root = P8ZP_SCRATCH_B1
            sta  _numl
            sty  _numh
            ldx  #$ff
            stx  _loop_counter
            inx
            stx  _root
            sec
_loop       lda  _numh
            sbc  #$40
            tay
            txa
            sbc  _root
            bcc  +
            sty  _numh
            bcs  ++
+           txa
+           rol  _root
            asl  _numl
            rol  _numh
            rol  a
            asl  _numl
            rol  _numh
            rol  a
            tax
            lsr  _loop_counter
            bne  _loop
            lda  _root
            rts
		.pend


func_sort_ub	.proc
		; 8bit unsigned sort
		; sorting subroutine coded by mats rosengren (mats.rosengren@esa.int)
		; input:  address of array to sort in P8ZP_SCRATCH_W1, length in S
		; first, put pointer BEFORE array
		sta  P8ZP_SCRATCH_B1
		lda  P8ZP_SCRATCH_W1
		bne  +
		dec  P8ZP_SCRATCH_W1+1
+		dec  P8ZP_SCRATCH_W1
_sortloop	ldy  P8ZP_SCRATCH_B1		;start of subroutine sort
		lda  (P8ZP_SCRATCH_W1),y	;last value in (what is left of) sequence to be sorted
		sta  P8ZP_SCRATCH_REG		;save value. will be over-written by largest number
		jmp  _l2
_l1		dey
		beq  _l3
		lda  (P8ZP_SCRATCH_W1),y
		cmp  P8ZP_SCRATCH_W2+1
		bcc  _l1
_l2		sty  P8ZP_SCRATCH_W2	;index of potentially largest value
		sta  P8ZP_SCRATCH_W2+1	;potentially largest value
		jmp  _l1
_l3		ldy  P8ZP_SCRATCH_B1		;where the largest value shall be put
		lda  P8ZP_SCRATCH_W2+1	;the largest value
		sta  (P8ZP_SCRATCH_W1),y	;put largest value in place
		ldy  P8ZP_SCRATCH_W2	;index of free space
		lda  P8ZP_SCRATCH_REG		;the over-written value
		sta  (P8ZP_SCRATCH_W1),y	;put the over-written value in the free space
		dec  P8ZP_SCRATCH_B1		;end of the shorter sequence still left
		bne  _sortloop			;start working with the shorter sequence
		rts
		.pend


func_sort_b	.proc
		; 8bit signed sort
		; sorting subroutine coded by mats rosengren (mats.rosengren@esa.int)
		; input:  address of array to sort in P8ZP_SCRATCH_W1, length in A
		; first, put pointer BEFORE array
		sta  P8ZP_SCRATCH_B1
		lda  P8ZP_SCRATCH_W1
		bne  +
		dec  P8ZP_SCRATCH_W1+1
+		dec  P8ZP_SCRATCH_W1
_sortloop	ldy  P8ZP_SCRATCH_B1		;start of subroutine sort
		lda  (P8ZP_SCRATCH_W1),y	;last value in (what is left of) sequence to be sorted
		sta  P8ZP_SCRATCH_REG		;save value. will be over-written by largest number
		jmp  _l2
_l1		dey
		beq  _l3
		lda  (P8ZP_SCRATCH_W1),y
		cmp  P8ZP_SCRATCH_W2+1
		bmi  _l1
_l2		sty  P8ZP_SCRATCH_W2	;index of potentially largest value
		sta  P8ZP_SCRATCH_W2+1	;potentially largest value
		jmp  _l1
_l3		ldy  P8ZP_SCRATCH_B1		;where the largest value shall be put
		lda  P8ZP_SCRATCH_W2+1	;the largest value
		sta  (P8ZP_SCRATCH_W1),y	;put largest value in place
		ldy  P8ZP_SCRATCH_W2	;index of free space
		lda  P8ZP_SCRATCH_REG		;the over-written value
		sta  (P8ZP_SCRATCH_W1),y	;put the over-written value in the free space
		dec  P8ZP_SCRATCH_B1		;end of the shorter sequence still left
		bne  _sortloop			;start working with the shorter sequence
		rts
		.pend


func_sort_uw	.proc
		; 16bit unsigned sort
		; sorting subroutine coded by mats rosengren (mats.rosengren@esa.int)
		; input:  address of array to sort in P8ZP_SCRATCH_W1, length in A
		; first: subtract 2 of the pointer
		asl  a
		sta  P8ZP_SCRATCH_B1
		lda  P8ZP_SCRATCH_W1
		sec
		sbc  #2
		sta  P8ZP_SCRATCH_W1
		bcs  _sort_loop
		dec  P8ZP_SCRATCH_W1+1
_sort_loop	ldy  P8ZP_SCRATCH_B1    	;start of subroutine sort
		lda  (P8ZP_SCRATCH_W1),y    ;last value in (what is left of) sequence to be sorted
		sta  _work3          		;save value. will be over-written by largest number
		iny
		lda  (P8ZP_SCRATCH_W1),y
		sta  _work3+1
		dey
		jmp  _l2
_l1		dey
		dey
		beq  _l3
		iny
		lda  (P8ZP_SCRATCH_W1),y
		dey
		cmp  P8ZP_SCRATCH_W2+1
		bne  +
		lda  (P8ZP_SCRATCH_W1),y
		cmp  P8ZP_SCRATCH_W2
+		bcc  _l1
_l2		sty  _work1          		;index of potentially largest value
		lda  (P8ZP_SCRATCH_W1),y
		sta  P8ZP_SCRATCH_W2          ;potentially largest value
		iny
		lda  (P8ZP_SCRATCH_W1),y
		sta  P8ZP_SCRATCH_W2+1
		dey
		jmp  _l1
_l3		ldy  P8ZP_SCRATCH_B1           ;where the largest value shall be put
		lda  P8ZP_SCRATCH_W2          ;the largest value
		sta  (P8ZP_SCRATCH_W1),y      ;put largest value in place
		iny
		lda  P8ZP_SCRATCH_W2+1
		sta  (P8ZP_SCRATCH_W1),y
		ldy  _work1         		 ;index of free space
		lda  _work3          		;the over-written value
		sta  (P8ZP_SCRATCH_W1),y      ;put the over-written value in the free space
		iny
		lda  _work3+1
		sta  (P8ZP_SCRATCH_W1),y
		dey
		dec  P8ZP_SCRATCH_B1           ;end of the shorter sequence still left
		dec  P8ZP_SCRATCH_B1
		bne  _sort_loop           ;start working with the shorter sequence
		rts
		.section BSS
_work1	.byte  ?
_work3	.word  ?
		.send BSS
		.pend


func_sort_w	.proc
		; 16bit signed sort
		; sorting subroutine coded by mats rosengren (mats.rosengren@esa.int)
		; input:  address of array to sort in P8ZP_SCRATCH_W1, length in A
		; first: subtract 2 of the pointer
		asl  a
		sta  P8ZP_SCRATCH_B1
		lda  P8ZP_SCRATCH_W1
		sec
		sbc  #2
		sta  P8ZP_SCRATCH_W1
		bcs  _sort_loop
		dec  P8ZP_SCRATCH_W1+1
_sort_loop	ldy  P8ZP_SCRATCH_B1    	;start of subroutine sort
		lda  (P8ZP_SCRATCH_W1),y    ;last value in (what is left of) sequence to be sorted
		sta  _work3          		;save value. will be over-written by largest number
		iny
		lda  (P8ZP_SCRATCH_W1),y
		sta  _work3+1
		dey
		jmp  _l2
_l1		dey
		dey
		beq  _l3
		lda  (P8ZP_SCRATCH_W1),y
		cmp  P8ZP_SCRATCH_W2
		iny
		lda  (P8ZP_SCRATCH_W1),y
		dey
		sbc  P8ZP_SCRATCH_W2+1
		bvc  +
		eor  #$80
+		bmi  _l1
_l2		sty  _work1          		;index of potentially largest value
		lda  (P8ZP_SCRATCH_W1),y
		sta  P8ZP_SCRATCH_W2          ;potentially largest value
		iny
		lda  (P8ZP_SCRATCH_W1),y
		sta  P8ZP_SCRATCH_W2+1
		dey
		jmp  _l1
_l3		ldy  P8ZP_SCRATCH_B1           ;where the largest value shall be put
		lda  P8ZP_SCRATCH_W2          ;the largest value
		sta  (P8ZP_SCRATCH_W1),y      ;put largest value in place
		iny
		lda  P8ZP_SCRATCH_W2+1
		sta  (P8ZP_SCRATCH_W1),y
		ldy  _work1         		 ;index of free space
		lda  _work3          		;the over-written value
		sta  (P8ZP_SCRATCH_W1),y      ;put the over-written value in the free space
		iny
		lda  _work3+1
		sta  (P8ZP_SCRATCH_W1),y
		dey
		dec  P8ZP_SCRATCH_B1           ;end of the shorter sequence still left
		dec  P8ZP_SCRATCH_B1
		bne  _sort_loop           ;start working with the shorter sequence
		rts
		.section BSS
_work1	.byte  ?
_work3	.word  ?
		.send BSS
		.pend


func_reverse_b	.proc
		; --- reverse an array of bytes (in-place)
		; inputs:  pointer to array in P8ZP_SCRATCH_W1, length in A
_index_right = P8ZP_SCRATCH_W2
_index_left = P8ZP_SCRATCH_W2+1
_loop_count = P8ZP_SCRATCH_REG
		sta  _loop_count
		lsr  _loop_count
		sec
		sbc  #1
		sta  _index_right
		lda  #0
		sta  _index_left
_loop		ldy  _index_right
		lda  (P8ZP_SCRATCH_W1),y
		pha
		ldy  _index_left
		lda  (P8ZP_SCRATCH_W1),y
		ldy  _index_right
		sta  (P8ZP_SCRATCH_W1),y
		pla
		ldy  _index_left
		sta  (P8ZP_SCRATCH_W1),y
		inc  _index_left
		dec  _index_right
		dec  _loop_count
		bne  _loop
		rts
		.pend


func_reverse_w	.proc
		; --- reverse an array of words (in-place)
		; inputs:  pointer to array in P8ZP_SCRATCH_W1, length in A
_index_first = P8ZP_SCRATCH_W2
_index_second = P8ZP_SCRATCH_W2+1
_loop_count = P8ZP_SCRATCH_REG
		pha
		asl  a     ; *2 because words
		sec
		sbc  #2
		sta  _index_first
		lda  #0
		sta  _index_second
		pla
		lsr  a
		pha
		sta  _loop_count
		; first reverse the lsbs
_loop_lo	ldy  _index_first
		lda  (P8ZP_SCRATCH_W1),y
		pha
		ldy  _index_second
		lda  (P8ZP_SCRATCH_W1),y
		ldy  _index_first
		sta  (P8ZP_SCRATCH_W1),y
		pla
		ldy  _index_second
		sta  (P8ZP_SCRATCH_W1),y
		inc  _index_second
		inc  _index_second
		dec  _index_first
		dec  _index_first
		dec  _loop_count
		bne  _loop_lo
		; now reverse the msbs
		dec  _index_second
		inc  _index_first
		inc  _index_first
		inc  _index_first
		pla
		sta  _loop_count
_loop_hi	ldy  _index_first
		lda  (P8ZP_SCRATCH_W1),y
		pha
		ldy  _index_second
		lda  (P8ZP_SCRATCH_W1),y
		ldy  _index_first
		sta  (P8ZP_SCRATCH_W1),y
		pla
		ldy  _index_second
		sta  (P8ZP_SCRATCH_W1),y
		dec  _index_second
		dec  _index_second
		inc  _index_first
		inc  _index_first
		dec  _loop_count
		bne  _loop_hi

		rts
		.pend


func_peek   .proc
	; -- read the byte value on the address in AY, into A
	sta  P8ZP_SCRATCH_W1
	sty  P8ZP_SCRATCH_W1+1
from_scratchW1
	ldy  #0
	lda  (P8ZP_SCRATCH_W1),y
	rts
	.pend

func_peekw   .proc
	; -- read the word value on the address in AY, into AY
	sta  P8ZP_SCRATCH_W1
	sty  P8ZP_SCRATCH_W1+1
from_scratchW1
	ldy  #0
	lda  (P8ZP_SCRATCH_W1),y
	pha
	iny
	lda  (P8ZP_SCRATCH_W1),y
	tay
	pla
	rts
	.pend

func_peekl   .proc
	; -- read the ;pmg value on the address in AY, into R14:R15
	sta  P8ZP_SCRATCH_W1
	sty  P8ZP_SCRATCH_W1+1
from_scratchW1
	ldy  #0
	lda  (P8ZP_SCRATCH_W1),y
	sta  cx16.r14
	iny
	lda  (P8ZP_SCRATCH_W1),y
	sta  cx16.r14+1
	iny
	lda  (P8ZP_SCRATCH_W1),y
	sta  cx16.r14+2
	iny
	lda  (P8ZP_SCRATCH_W1),y
	sta  cx16.r14+3
	rts
	.pend


func_pokew   .proc
	; -- store the word value in AY in the address in P8ZP_SCRATCH_W1
	sty  P8ZP_SCRATCH_REG
	ldy  #0
	sta  (P8ZP_SCRATCH_W1),y
	iny
	lda  P8ZP_SCRATCH_REG
	sta  (P8ZP_SCRATCH_W1),y
	rts
	.pend

func_pokew_scratchW2   .proc
	; -- store the word value in AY in the address in P8ZP_SCRATCH_W2
	sty  P8ZP_SCRATCH_REG
	ldy  #0
	sta  (P8ZP_SCRATCH_W2),y
	iny
	lda  P8ZP_SCRATCH_REG
	sta  (P8ZP_SCRATCH_W2),y
	rts
	.pend

func_pokel   .proc
	; -- store the long value in R14:R15 in the address in AY
	sta  P8ZP_SCRATCH_W1
	sty  P8ZP_SCRATCH_W1+1
	ldy  #0
	lda  cx16.r14
	sta  (P8ZP_SCRATCH_W1),y
	iny
	lda  cx16.r14+1
	sta  (P8ZP_SCRATCH_W1),y
	iny
	lda  cx16.r14+2
	sta  (P8ZP_SCRATCH_W1),y
	iny
	lda  cx16.r14+3
	sta  (P8ZP_SCRATCH_W1),y
	rts
	.pend

func_clamp_byte .proc
	; signed value in A, result in A
	; minimum in P8ZP_SCRATCH_W1
	; maximum in P8ZP_SCRATCH_W1+1
	tay
	sec
	sbc  P8ZP_SCRATCH_W1+1
	bvc  +
	eor  #$80
+       bmi  +
	lda  P8ZP_SCRATCH_W1+1
	tay
	jmp  ++
+       tya
+	sec
	sbc  P8ZP_SCRATCH_W1
	bvc  +
	eor  #$80
+       bmi  +
	tya
	rts
+       lda  P8ZP_SCRATCH_W1
	rts
	.pend


func_clamp_ubyte .proc
	; value in A, result in A
	; minimum in P8ZP_SCRATCH_W1
	; maximum in P8ZP_SCRATCH_W1+1
	cmp  P8ZP_SCRATCH_W1+1
	bcc  +
	lda  P8ZP_SCRATCH_W1+1
+       cmp  P8ZP_SCRATCH_W1
	bcc  +
	rts
+       lda  P8ZP_SCRATCH_W1
	rts
	.pend

func_clamp_word .proc
	; signed value in AY, result in AY
	; minimum in P8ZP_SCRATCH_W1
	; maximum in P8ZP_SCRATCH_W2
	sta  P8ZP_SCRATCH_B1
	sty  P8ZP_SCRATCH_REG
	ldy  P8ZP_SCRATCH_W2+1
	lda  P8ZP_SCRATCH_W2
	cmp  P8ZP_SCRATCH_B1
	tya
	sbc  P8ZP_SCRATCH_REG
	bvc  +
	eor  #$80
+       bpl  +
	lda  P8ZP_SCRATCH_W2
	ldy  P8ZP_SCRATCH_W2+1
	sta  P8ZP_SCRATCH_B1
	sty  P8ZP_SCRATCH_REG
+	ldy  P8ZP_SCRATCH_W1+1
	lda  P8ZP_SCRATCH_W1
	cmp  P8ZP_SCRATCH_B1
	tya
	sbc  P8ZP_SCRATCH_REG
	bvc  +
	eor  #$80
+       bpl  +
	ldy  P8ZP_SCRATCH_REG
	lda  P8ZP_SCRATCH_B1
	rts
+	ldy  P8ZP_SCRATCH_W1+1
	lda  P8ZP_SCRATCH_W1
	rts
	.pend

func_clamp_uword .proc
	; value in AY, result in AY
	; minimum in P8ZP_SCRATCH_W1
	; maximum in P8ZP_SCRATCH_W2
	sta  P8ZP_SCRATCH_B1
	sty  P8ZP_SCRATCH_REG
	cpy  P8ZP_SCRATCH_W2+1
	bcc  ++
	bne  +
	cmp  P8ZP_SCRATCH_W2
	bcc  ++
+       beq  +
	lda  P8ZP_SCRATCH_W2
	ldy  P8ZP_SCRATCH_W2+1
	sta  P8ZP_SCRATCH_B1
	sty  P8ZP_SCRATCH_REG
+	ldy  P8ZP_SCRATCH_REG
	lda  P8ZP_SCRATCH_B1
	cpy  P8ZP_SCRATCH_W1+1
	bcc  ++
	bne  +
	cmp  P8ZP_SCRATCH_W1
	bcc  ++
+       beq  +
	ldy  P8ZP_SCRATCH_REG
	lda  P8ZP_SCRATCH_B1
	rts
+	ldy  P8ZP_SCRATCH_W1+1
	lda  P8ZP_SCRATCH_W1
	rts

	.pend
	.pend
; global float constants
; struct types
; struct instances without initialization values, as BSS zeroed at startup
	.section BSS
prog8_struct_instances_bss  .block
	.endblock
	.send BSS
; struct instances with initialization values
	.section STRUCTINSTANCES
prog8_struct_instances  .block
	.endblock
	.send STRUCTINSTANCES
	.dsection STRUCTINSTANCES
; bss sections
PROG8_VARSHIGH_RAMBANK = 1
	.dsection BSS_NOCLEAR
prog8_bss_section_start
	.dsection BSS
prog8_bss_section_size = * - prog8_bss_section_start
	.dsection BSS_SLABS
prog8_program_end	; end of program label for progend()
	; memtop check
	.cerror * >= $8000, "Program too long by ", * - $7fff, " bytes, memtop=$8000"
